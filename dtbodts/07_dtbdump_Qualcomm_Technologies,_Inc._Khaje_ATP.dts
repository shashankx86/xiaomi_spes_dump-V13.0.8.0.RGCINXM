/dts-v1/;

/ {
	compatible = "qcom,khaje-atp", "qcom,khaje", "qcom,atp";
	model = "Qualcomm Technologies, Inc. Khaje ATP";
	qcom,board-id = <0x21 0x0>;
	qcom,msm-id = <0x206 0x10000>;
	qcom,pmic-id = <0x2d 0x2e 0x0 0x0>;

	__fixups__ {
		L11A = "/fragment@14/__overlay__:vdd-io-supply:0", "/fragment@17/__overlay__:vccq2-supply:0";
		L15A = "/fragment@9/__overlay__/qcom,pm7250b@2/qcom,usb-pdphy@1700:vdd-pdphy-supply:0";
		L18A = "/fragment@16/__overlay__:vdda-pll-supply:0", "/fragment@17/__overlay__:qcom,vddp-ref-clk-supply:0";
		L22A = "/fragment@15/__overlay__:vdd-supply:0";
		L24A = "/fragment@14/__overlay__:vdd-supply:0", "/fragment@17/__overlay__:vcc-supply:0";
		L4A = "/fragment@16/__overlay__:vdda-phy-supply:0";
		L5A = "/fragment@15/__overlay__:vdd-io-supply:0";
		L7A = "/fragment@15/__overlay__:vdd-io-bias-supply:0";
		camera_therm_default = "/fragment@19/__overlay__:pinctrl-0:0";
		emmc_therm_default = "/fragment@19/__overlay__:pinctrl-0:4";
		gcc_ufs_phy_gdsc = "/fragment@17/__overlay__:vdd-hba-supply:0";
		mdss_dsi0 = "/fragment@7/__overlay__/qcom,dsi-display-primary:qcom,dsi-ctrl:0";
		mdss_dsi0_pll = "/fragment@7/__overlay__/qcom,dsi-display-primary:clocks:0", "/fragment@7/__overlay__/qcom,dsi-display-primary:clocks:8", "/fragment@7/__overlay__/qcom,dsi-display-primary:clocks:16", "/fragment@7/__overlay__/qcom,dsi-display-primary:clocks:24", "/fragment@7/__overlay__/qcom,dsi-display-primary:clocks:32", "/fragment@7/__overlay__/qcom,dsi-display-primary:clocks:40";
		mdss_dsi_phy0 = "/fragment@7/__overlay__/qcom,dsi-display-primary:qcom,dsi-phy:0";
		mdss_mdp = "/fragment@0:target:0", "/fragment@1:target:0", "/fragment@2:target:0", "/fragment@3:target:0", "/fragment@4:target:0", "/fragment@5:target:0", "/fragment@6:target:0", "/fragment@7/__overlay__/qcom,dsi-display-primary:qcom,mdp:0", "/fragment@8:target:0";
		pm6125_adc_tm = "/fragment@20:target:0", "/fragment@21/__overlay__/rf-pa1-therm-usr:thermal-sensors:0";
		pm6125_gpios = "/fragment@2/__overlay__/qcom,mdss_dsi_panel_k7_38_0c_0a_fhdp_video:qcom,platform-en-gpio:0", "/fragment@3/__overlay__/qcom,mdss_dsi_panel_k7_38_0c_0b_fhdp_video:qcom,platform-en-gpio:0", "/fragment@7/__overlay__/qcom,dsi-display-primary:qcom,platform-en-gpio:0", "/fragment@12:target:0", "/fragment@13/__overlay__/vdda_usb_ss_dp_core:gpio:0", "/fragment@22:target:0", "/fragment@23/__overlay__/gpio_keys/vol_up:gpios:0";
		pm6125_pwm = "/fragment@4/__overlay__/qcom,mdss_dsi_nt36672e_fhd_plus_90hz_video:pwms:0", "/fragment@26:target:0";
		pm6125_vadc = "/fragment@19:target:0", "/fragment@20/__overlay__:io-channels:0", "/fragment@20/__overlay__:io-channels:8", "/fragment@20/__overlay__:io-channels:16", "/fragment@20/__overlay__:io-channels:24";
		pm8008_8 = "/fragment@24:target:0";
		pm8008_9 = "/fragment@25:target:0";
		qupv3_se2_i2c = "/fragment@27:target:0";
		rpmcc = "/fragment@9/__overlay__/qcom,pm7250b@2/clock-controller@5b00:clocks:0";
		sdc1_clk_off = "/fragment@14/__overlay__:pinctrl-1:0";
		sdc1_clk_on = "/fragment@14/__overlay__:pinctrl-0:0";
		sdc1_cmd_off = "/fragment@14/__overlay__:pinctrl-1:4";
		sdc1_cmd_on = "/fragment@14/__overlay__:pinctrl-0:4";
		sdc1_data_off = "/fragment@14/__overlay__:pinctrl-1:8";
		sdc1_data_on = "/fragment@14/__overlay__:pinctrl-0:8";
		sdc1_rclk_off = "/fragment@14/__overlay__:pinctrl-1:12";
		sdc1_rclk_on = "/fragment@14/__overlay__:pinctrl-0:12";
		sdc2_cd_off = "/fragment@15/__overlay__:pinctrl-1:12";
		sdc2_cd_on = "/fragment@15/__overlay__:pinctrl-0:12";
		sdc2_clk_off = "/fragment@15/__overlay__:pinctrl-1:0";
		sdc2_clk_on = "/fragment@15/__overlay__:pinctrl-0:0";
		sdc2_cmd_off = "/fragment@15/__overlay__:pinctrl-1:4";
		sdc2_cmd_on = "/fragment@15/__overlay__:pinctrl-0:4";
		sdc2_data_off = "/fragment@15/__overlay__:pinctrl-1:8";
		sdc2_data_on = "/fragment@15/__overlay__:pinctrl-0:8";
		sde_dsi_active = "/fragment@7/__overlay__/qcom,dsi-display-primary:pinctrl-0:0";
		sde_dsi_suspend = "/fragment@7/__overlay__/qcom,dsi-display-primary:pinctrl-1:0";
		sde_te_active = "/fragment@7/__overlay__/qcom,dsi-display-primary:pinctrl-0:4";
		sde_te_suspend = "/fragment@7/__overlay__/qcom,dsi-display-primary:pinctrl-1:4";
		sdhc_1 = "/fragment@14:target:0";
		sdhc_2 = "/fragment@15:target:0";
		soc = "/fragment@7:target:0", "/fragment@13:target:0", "/fragment@23:target:0";
		spmi_bus = "/fragment@9:target:0";
		thermal_zones = "/fragment@10:target:0", "/fragment@11:target:0", "/fragment@21:target:0";
		tlmm = "/fragment@2/__overlay__/qcom,mdss_dsi_panel_k7_38_0c_0a_fhdp_video:qcom,esd-err-irq-gpio:0", "/fragment@3/__overlay__/qcom,mdss_dsi_panel_k7_38_0c_0b_fhdp_video:qcom,esd-err-irq-gpio:0", "/fragment@4/__overlay__/qcom,mdss_dsi_nt36672e_fhd_plus_90hz_video:qcom,platform-reset-gpio:0", "/fragment@6/__overlay__/qcom,mdss_dsi_sim_video:qcom,platform-reset-gpio:0", "/fragment@7/__overlay__/qcom,dsi-display-primary:qcom,platform-te-gpio:0", "/fragment@15/__overlay__:cd-gpios:0", "/fragment@27/__overlay__/novatek@62:interrupt-parent:0", "/fragment@27/__overlay__/novatek@62:novatek,reset-gpio:0", "/fragment@27/__overlay__/novatek@62:novatek,irq-gpio:0";
		ts_int_active = "/fragment@27/__overlay__/novatek@62:pinctrl-0:0";
		ts_int_suspend = "/fragment@27/__overlay__/novatek@62:pinctrl-1:0";
		ts_release = "/fragment@27/__overlay__/novatek@62:pinctrl-2:0";
		ts_reset_active = "/fragment@27/__overlay__/novatek@62:pinctrl-0:4";
		ts_reset_suspend = "/fragment@27/__overlay__/novatek@62:pinctrl-1:4";
		ufshc_mem = "/fragment@17:target:0";
		ufsphy_mem = "/fragment@16:target:0";
		usb2_phy0 = "/fragment@9/__overlay__/qcom,pm7250b@2/qcom,qpnp-smb5:dpdm-supply:0";
		usb_qmp_dp_phy = "/fragment@18:target:0";
	};

	__local_fixups__ {

		fragment@10 {

			__overlay__ {

				pm7250b-bcl-lvl0 {
					thermal-sensors = <0x0>;
				};

				pm7250b-bcl-lvl1 {
					thermal-sensors = <0x0>;
				};

				pm7250b-bcl-lvl2 {
					thermal-sensors = <0x0>;
				};

				pm7250b-ibat-lvl0 {
					thermal-sensors = <0x0>;
				};

				pm7250b-ibat-lvl1 {
					thermal-sensors = <0x0>;
				};

				pm7250b-tz {
					thermal-sensors = <0x0>;
				};

				pm7250b-vbat-lvl0 {
					thermal-sensors = <0x0>;
				};

				pm7250b-vbat-lvl1 {
					thermal-sensors = <0x0>;
				};

				pm7250b-vbat-lvl2 {
					thermal-sensors = <0x0>;
				};

				soc {
					thermal-sensors = <0x0>;
				};
			};
		};

		fragment@11 {

			__overlay__ {

				charger-therm-usr {
					thermal-sensors = <0x0>;
				};

				conn-therm-usr {
					thermal-sensors = <0x0>;
				};
			};
		};

		fragment@13 {

			__overlay__ {

				vdda_usb_ss_dp_core {
					pinctrl-0 = <0x0>;
				};
			};
		};

		fragment@18 {

			__overlay__ {
				vdd-supply = <0x0>;
			};
		};

		fragment@19 {

			__overlay__ {
				pinctrl-0 = <0x8>;
			};
		};

		fragment@23 {

			__overlay__ {

				gpio_keys {
					pinctrl-0 = <0x0>;
				};
			};
		};

		fragment@27 {

			__overlay__ {

				novatek@62 {
					panel = <0x0>;
				};
			};
		};

		fragment@4 {

			__overlay__ {

				qcom,mdss_dsi_nt36672e_fhd_plus_90hz_video {
					qcom,panel-supply-entries = <0x0>;
					qcom,platform-bklight-en-gpio = <0x0>;
					qcom,platform-en-gpio = <0x0>;
				};
			};
		};

		fragment@6 {

			__overlay__ {

				qcom,mdss_dsi_sim_video {
					qcom,panel-supply-entries = <0x0>;
				};
			};
		};

		fragment@7 {

			__overlay__ {

				qcom,dsi-display-primary {
					pinctrl-0 = <0x8>;
					qcom,dsi-default-panel = <0x0>;
				};

				qcom,msm_notifier@0 {
					panel = <0x0 0x4>;
				};
			};
		};

		fragment@8 {

			__overlay__ {
				connectors = <0x0>;
			};
		};

		fragment@9 {

			__overlay__ {

				qcom,pm7250b@2 {

					adc_tm@3500 {
						io-channels = <0x0 0x8>;
					};

					clock-controller@5b00 {
						assigned-clocks = <0x0>;
					};

					qcom,qpnp-smb5 {
						io-channels = <0x0 0x8 0x10 0x18 0x20 0x28 0x30>;
						qcom,pmic-revid = <0x0>;
					};

					qcom,temp-alarm@2400 {
						io-channels = <0x0>;
					};

					qcom,usb-pdphy@1700 {
						vbus-supply = <0x0>;
						vconn-supply = <0x0>;
					};

					qpnp,qg {
						io-channels = <0x0 0x8>;
						qcom,pmic-revid = <0x0>;
					};
				};
			};
		};
	};

	__symbols__ {
		b_bcl_lvl0 = "/fragment@10/__overlay__/pm7250b-bcl-lvl0/trips/b-bcl-lvl0";
		b_bcl_lvl1 = "/fragment@10/__overlay__/pm7250b-bcl-lvl1/trips/b-bcl-lvl1";
		b_bcl_lvl2 = "/fragment@10/__overlay__/pm7250b-bcl-lvl2/trips/b-bcl-lvl2";
		bcl_soc = "/fragment@9/__overlay__/qcom,pm7250b@2/bcl-soc";
		disp_lcd_bias_en_default = "/fragment@9/__overlay__/qcom,pm7250b@2/pinctrl@c000/disp_lcd_bias_en/disp_lcd_bias_en_default";
		dsi_k7_38_0c_0a_video = "/fragment@2/__overlay__/qcom,mdss_dsi_panel_k7_38_0c_0a_fhdp_video";
		dsi_k7_38_0c_0b_video = "/fragment@3/__overlay__/qcom,mdss_dsi_panel_k7_38_0c_0b_fhdp_video";
		dsi_nt36672e_fhd_plus_120hz_video = "/fragment@5/__overlay__/qcom,mdss_dsi_nt36672e_fhd_plus_120hz_video";
		dsi_nt36672e_fhd_plus_90hz_video = "/fragment@4/__overlay__/qcom,mdss_dsi_nt36672e_fhd_plus_90hz_video";
		dsi_panel_pwr_supply_no_labibb = "/fragment@7/__overlay__/dsi_panel_pwr_supply_no_labibb";
		dsi_sim_vid = "/fragment@6/__overlay__/qcom,mdss_dsi_sim_video";
		dsi_td4330_truly_v2_cmd = "/fragment@0/__overlay__/qcom,mdss_dsi_td4330_truly_v2_cmd";
		dsi_td4330_truly_v2_video = "/fragment@1/__overlay__/qcom,mdss_dsi_td4330_truly_v2_video";
		ibat_lvl0 = "/fragment@10/__overlay__/pm7250b-ibat-lvl0/trips/ibat-lvl0";
		ibat_lvl1 = "/fragment@10/__overlay__/pm7250b-ibat-lvl1/trips/ibat-lvl1";
		key_vol_up_default = "/fragment@22/__overlay__/key_vol_up/key_vol_up_default";
		msm_notifier = "/fragment@7/__overlay__/qcom,msm_notifier@0";
		pm7250b_adc_tm = "/fragment@9/__overlay__/qcom,pm7250b@2/adc_tm@3500";
		pm7250b_bcl = "/fragment@9/__overlay__/qcom,pm7250b@2/bcl@1d00";
		pm7250b_charger = "/fragment@9/__overlay__/qcom,pm7250b@2/qcom,qpnp-smb5";
		pm7250b_clkdiv = "/fragment@9/__overlay__/qcom,pm7250b@2/clock-controller@5b00";
		pm7250b_gpios = "/fragment@9/__overlay__/qcom,pm7250b@2/pinctrl@c000";
		pm7250b_pdphy = "/fragment@9/__overlay__/qcom,pm7250b@2/qcom,usb-pdphy@1700";
		pm7250b_qg = "/fragment@9/__overlay__/qcom,pm7250b@2/qpnp,qg";
		pm7250b_revid = "/fragment@9/__overlay__/qcom,pm7250b@2/qcom,revid@100";
		pm7250b_temp_alarm = "/fragment@10/__overlay__/pm7250b-tz";
		pm7250b_trip0 = "/fragment@10/__overlay__/pm7250b-tz/trips/trip0";
		pm7250b_trip1 = "/fragment@10/__overlay__/pm7250b-tz/trips/trip1";
		pm7250b_tz = "/fragment@9/__overlay__/qcom,pm7250b@2/qcom,temp-alarm@2400";
		pm7250b_vadc = "/fragment@9/__overlay__/qcom,pm7250b@2/vadc@3100";
		pm7250b_vib = "/fragment@9/__overlay__/qcom,pm7250b@3/qcom,vibrator@5300";
		rf_pa1_therm_default = "/fragment@22/__overlay__/rf_pa1_therm/rf_pa1_therm_default";
		sde_dsi = "/fragment@7/__overlay__/qcom,dsi-display-primary";
		sde_wb = "/fragment@7/__overlay__/qcom,wb-display@0";
		smb5_vbus = "/fragment@9/__overlay__/qcom,pm7250b@2/qcom,qpnp-smb5/qcom,smb5-vbus";
		smb5_vconn = "/fragment@9/__overlay__/qcom,pm7250b@2/qcom,qpnp-smb5/qcom,smb5-vconn";
		soc_trip = "/fragment@10/__overlay__/soc/trips/soc-trip";
		usb_eldo9 = "/fragment@12/__overlay__/eldo9_pin/gpio@c000";
		vbat_lvl0 = "/fragment@10/__overlay__/pm7250b-vbat-lvl0/trips/vbat-lvl0";
		vbat_lvl1 = "/fragment@10/__overlay__/pm7250b-vbat-lvl1/trips/vbat-lvl1";
		vbat_lvl2 = "/fragment@10/__overlay__/pm7250b-vbat-lvl2/trips/vbat-lvl2";
		vdda_usb_ss_dp_core = "/fragment@13/__overlay__/vdda_usb_ss_dp_core";
	};

	fragment@0 {
		target = <0xffffffff>;

		__overlay__ {

			qcom,mdss_dsi_td4330_truly_v2_cmd {
				phandle = <0x14>;
				qcom,dsi-ctrl-num = <0x0>;
				qcom,dsi-dyn-clk-enable;
				qcom,dsi-dyn-clk-list = <0x38491ab0 0x3758f3d0 0x3794fd88 0x37d10740 0x380d10f0>;
				qcom,dsi-phy-num = <0x0>;
				qcom,dsi-select-clocks = "mux_byte_clk0", "mux_pixel_clk0";
				qcom,mdss-dsi-bl-max-level = <0xfff>;
				qcom,mdss-dsi-bl-min-level = <0x1>;
				qcom,mdss-dsi-bl-pmic-control-type = "bl_ctrl_wled";
				qcom,mdss-dsi-bllp-eof-power-mode;
				qcom,mdss-dsi-bllp-power-mode;
				qcom,mdss-dsi-border-color = <0x0>;
				qcom,mdss-dsi-bpp = <0x18>;
				qcom,mdss-dsi-color-order = "rgb_swap_rgb";
				qcom,mdss-dsi-dma-trigger = "trigger_sw";
				qcom,mdss-dsi-h-sync-pulse = <0x0>;
				qcom,mdss-dsi-lane-0-state;
				qcom,mdss-dsi-lane-1-state;
				qcom,mdss-dsi-lane-2-state;
				qcom,mdss-dsi-lane-3-state;
				qcom,mdss-dsi-lane-map = "lane_map_0123";
				qcom,mdss-dsi-lp11-init;
				qcom,mdss-dsi-mdp-trigger = "none";
				qcom,mdss-dsi-panel-mode-switch;
				qcom,mdss-dsi-panel-name = "td4330 v2 cmd mode dsi truly panel";
				qcom,mdss-dsi-panel-type = "dsi_cmd_mode";
				qcom,mdss-dsi-reset-sequence = <0x1 0xa 0x0 0xa 0x1 0xa>;
				qcom,mdss-dsi-stream = <0x0>;
				qcom,mdss-dsi-te-check-enable;
				qcom,mdss-dsi-te-dcs-command = <0x1>;
				qcom,mdss-dsi-te-pin-select = <0x1>;
				qcom,mdss-dsi-te-using-te-pin;
				qcom,mdss-dsi-traffic-mode = "non_burst_sync_event";
				qcom,mdss-dsi-tx-eot-append;
				qcom,mdss-dsi-underflow-color = <0xff>;
				qcom,mdss-dsi-virtual-channel-id = <0x0>;
				qcom,mdss-dsi-wr-mem-continue = <0x3c>;
				qcom,mdss-dsi-wr-mem-start = <0x2c>;
				qcom,ulps-enabled;

				qcom,mdss-dsi-display-timings {

					timing@0 {
						qcom,default-topology-index = <0x0>;
						qcom,display-topology = <0x1 0x0 0x1>;
						qcom,mdss-dsi-cmd-mode;
						qcom,mdss-dsi-h-back-porch = <0x50>;
						qcom,mdss-dsi-h-front-porch = <0x50>;
						qcom,mdss-dsi-h-pulse-width = <0x14>;
						qcom,mdss-dsi-h-sync-skew = <0x0>;
						qcom,mdss-dsi-off-command = [05 01 00 00 32 00 02 28 00 05 01 00 00 96 00 02 10 00];
						qcom,mdss-dsi-off-command-state = "dsi_hs_mode";
						qcom,mdss-dsi-on-command = [29 01 00 00 00 00 02 b0 00 29 01 00 00 00 00 0d b6 30 6b 00 06 03 0a 13 1a 6c 18 19 02 29 01 00 00 00 00 05 b7 40 00 00 00 29 01 00 00 00 00 08 b8 57 3d 19 be 1e 0a 0a 29 01 00 00 00 00 08 b9 6f 3d 28 be 3c 14 0a 29 01 00 00 00 00 08 ba b5 33 41 be 64 23 0a 29 01 00 00 00 00 0c bb 44 26 c3 1f 19 06 03 c0 00 00 10 29 01 00 00 00 00 0c bc 32 4c c3 52 32 1f 03 f2 00 00 13 29 01 00 00 00 00 0c bd 24 68 c3 aa 3f 32 03 ff 00 00 25 29 01 00 00 00 00 0d be 00 00 00 00 00 00 00 00 00 00 00 00 29 01 00 00 00 00 0d c0 00 dc 00 dc 04 08 e8 00 04 00 03 78 29 01 00 00 00 00 24 c1 30 00 00 11 11 00 00 00 22 00 05 20 fa 00 08 00 00 00 00 00 00 00 00 00 00 00 00 00 00 00 00 00 00 00 00 29 01 00 00 00 00 79 c2 06 e0 6e 01 03 00 02 00 00 00 00 00 00 00 00 00 00 00 00 00 00 00 00 00 00 00 00 00 00 00 00 00 00 00 00 00 00 00 00 00 00 11 00 00 00 00 04 a0 c9 00 00 00 00 00 00 48 eb 00 00 01 00 00 00 11 00 00 00 00 00 00 00 00 00 00 00 00 00 00 00 00 00 00 00 00 11 00 00 00 00 00 00 dc 00 00 00 00 04 00 08 ef 00 00 00 00 00 11 00 00 00 00 00 00 00 00 00 00 00 00 00 00 29 01 00 00 00 00 6d c3 00 00 00 00 00 00 00 00 00 00 00 00 00 00 00 00 00 00 00 00 00 00 00 00 00 00 00 00 00 00 00 00 00 00 00 00 00 00 00 00 00 00 00 00 00 00 00 00 00 00 00 00 00 00 00 00 00 00 00 00 00 00 aa aa aa 00 00 00 00 00 00 00 00 00 00 00 00 00 00 00 00 00 00 00 00 00 00 00 00 00 00 00 00 00 00 00 00 00 00 00 00 00 00 00 00 00 00 00 29 01 00 00 00 00 62 c4 00 4c 00 3f 00 83 00 00 87 86 85 84 00 00 00 00 00 61 5d 5f 00 5e 60 62 00 00 00 02 00 83 00 00 87 86 85 84 00 00 00 00 00 61 5d 5f 00 5e 60 62 ff ff ff ff ff ff 00 0f 0e 00 0f 0e 00 00 00 00 00 00 00 0f ee 00 0f ee 00 00 e0 00 00 e0 0e 00 00 00 0e 00 00 00 00 00 ff 57 00 00 00 00 00 00 00 29 01 00 00 00 00 06 c5 08 00 00 00 00 29 01 00 00 00 00 3a c6 02 0a 08 fc ff ff ff 00 00 13 01 f0 0c 06 01 43 43 43 00 00 00 01 77 09 28 28 06 01 43 43 43 00 00 00 01 61 00 00 00 1c 01 00 00 00 00 00 00 00 00 00 00 00 00 20 20 00 00 29 01 00 00 00 00 4d c7 00 00 00 e0 01 e9 02 7e 02 05 02 90 02 f6 02 40 02 5c 02 77 02 c8 02 1b 02 5b 02 bd 02 27 02 c3 03 54 03 d8 03 ff 00 00 00 e0 01 e9 02 7e 02 05 02 90 02 f6 02 40 02 5c 02 77 02 c8 02 1b 02 5b 02 bd 02 27 02 c3 03 54 03 d8 03 ff 29 01 00 00 00 00 42 c8 41 00 ff fa 00 ff 00 00 fe f6 fe e9 00 00 ff f7 fb e1 00 00 00 00 00 ff 00 00 ff fa 00 ff 00 fe f6 fe e9 00 ff f7 fb e1 00 00 00 00 ff 00 ff fa 00 ff 00 fe f6 fe e9 00 ff f7 fb e1 00 00 00 00 ff 29 01 00 00 00 00 19 c9 00 ff fa 00 ff 00 00 fe f6 fe e9 00 00 ff f7 fb e1 00 00 00 00 00 ff 00 29 01 00 00 00 00 42 ca 1c fc fc fc 00 00 00 00 00 00 00 00 00 00 00 00 00 00 00 00 00 00 00 00 00 00 00 00 00 00 00 00 00 00 00 00 00 00 00 00 00 00 00 00 00 00 00 00 00 00 00 00 00 00 00 00 00 00 00 00 00 00 00 00 00 29 01 00 00 00 00 0b cc 00 00 4d 8b 55 4d 8b aa 4d 8b 29 01 00 00 00 00 02 cd 00 29 01 00 00 00 00 24 ce 5d 40 49 53 59 5e 63 68 6e 74 7e 8a 98 a8 bb d0 e7 ff 04 00 04 04 42 04 69 5a 40 11 f4 00 00 84 fa 00 00 29 01 00 00 00 00 07 cf 00 00 80 46 61 00 29 01 00 00 00 00 12 d0 f6 95 11 b1 55 cf 00 f6 d3 11 f0 01 12 cf 02 20 11 29 01 00 00 00 00 23 d1 d3 d3 33 33 07 03 3b 33 77 37 77 37 35 77 07 77 f7 33 73 07 33 33 03 33 1b 03 32 3d 0a 30 13 13 20 00 29 01 00 00 00 00 05 d2 00 00 07 00 29 01 00 00 00 00 9a d3 03 00 00 00 00 00 00 0f 00 57 00 00 32 00 00 1a 70 01 19 80 01 01 f0 02 00 e0 06 ff f7 ff ff f7 ff ff f7 ff ff f7 ff ff f7 ff ff f7 ff ff f7 ff ff f7 ff ff f7 ff ff f7 ff ff f7 ff ff f7 ff ff f7 ff ff f7 ff ff f7 ff ff f7 ff ff f7 ff ff f7 ff ff f7 ff ff f7 ff ff f7 ff ff f7 ff ff f7 ff ff f7 ff ff f7 ff ff f7 ff ff f7 ff ff f7 ff ff f7 ff ff f7 ff ff f7 ff ff f7 ff ff f7 ff ff f7 ff ff f7 ff ff f7 ff ff f7 ff ff f7 ff ff f7 ff ff f7 ff ff f7 ff ff f7 ff 29 01 00 00 00 00 05 e5 03 00 00 00 29 01 00 00 00 00 09 d5 02 42 02 42 02 dc 02 dc 29 01 00 00 00 00 02 d6 c0 29 01 00 00 00 00 32 d7 21 10 52 52 00 b6 04 fd 00 b6 04 fd 00 82 80 83 84 85 83 80 84 45 85 85 85 87 04 06 02 04 04 07 10 0c 0b 0a 0a 07 06 00 08 00 00 00 00 00 00 00 00 29 01 00 00 00 00 05 dd 30 06 23 65 29 01 00 00 00 00 0d de 00 00 00 0f ff 00 00 00 00 00 00 10 29 01 00 00 00 00 02 e3 ff 29 01 00 00 00 00 07 e6 00 00 00 00 00 00 29 01 00 00 00 00 0b e7 50 04 00 00 00 00 00 00 00 00 29 01 00 00 00 00 05 e8 00 01 23 00 29 01 00 00 00 00 1e ea 01 02 47 80 47 00 00 00 05 00 13 60 02 47 80 47 00 00 00 00 13 60 00 11 00 30 10 21 02 29 01 00 00 00 00 08 eb 00 00 00 00 01 00 11 29 01 00 00 00 00 04 ec 00 00 00 29 01 00 00 00 00 21 ed 01 01 02 02 02 02 00 00 00 00 00 00 0a 00 00 00 00 10 00 18 00 18 00 b0 00 00 00 00 00 da 10 00 29 01 00 00 00 00 61 ee 03 0f 00 00 00 00 40 1f 00 00 0f f2 3f 00 00 00 00 00 00 00 00 00 00 00 00 00 00 00 10 01 00 09 01 8c d8 ef 00 00 00 00 00 00 00 00 00 00 00 00 00 00 00 00 00 00 50 1f 00 00 00 00 00 00 00 00 00 00 00 00 00 00 00 00 00 00 00 00 00 00 00 00 00 00 00 00 00 00 00 00 00 00 00 00 00 00 00 00 29 01 00 00 00 00 8c ef 00 70 4a 08 d0 00 00 00 00 3c 3c 3c 00 00 00 00 00 00 00 00 00 00 00 00 00 00 00 00 70 4a 08 d0 00 00 00 00 3c 3c 3c 00 00 00 00 00 00 00 00 00 00 00 00 00 00 00 00 00 00 00 00 00 00 00 00 00 00 00 00 00 00 00 00 00 00 00 00 00 00 00 00 00 00 00 00 00 00 00 00 00 00 00 00 00 03 08 ec 50 10 00 10 00 0a 0a 00 00 00 00 10 0f 00 03 51 00 50 00 00 00 00 00 00 00 00 00 00 00 00 00 00 00 00 00 00 00 00 00 00 00 03 08 ec 29 01 00 00 00 00 02 b0 03 29 01 00 00 00 00 02 b0 04 29 01 00 00 00 00 02 d6 00 39 01 00 00 00 00 03 51 ff f0 39 01 00 00 00 00 02 53 0c 39 01 00 00 00 00 02 55 00 39 01 00 00 00 00 02 35 00 39 01 00 00 00 00 05 2a 00 00 04 37 39 01 00 00 00 00 05 2b 00 00 08 e7 05 01 00 00 ff 00 02 29 00 05 01 00 00 ff 00 02 11 00];
						qcom,mdss-dsi-on-command-state = "dsi_lp_mode";
						qcom,mdss-dsi-panel-framerate = <0x3c>;
						qcom,mdss-dsi-panel-height = <0x8e8>;
						qcom,mdss-dsi-panel-jitter = <0x4 0x1>;
						qcom,mdss-dsi-panel-phy-timings = [00 23 09 09 26 24 09 09 09 02 04 00 1e 19];
						qcom,mdss-dsi-panel-width = <0x438>;
						qcom,mdss-dsi-v-back-porch = <0xd>;
						qcom,mdss-dsi-v-front-porch = <0x10>;
						qcom,mdss-dsi-v-pulse-width = <0x2>;
						qcom,panel-roi-alignment = <0x28 0x28 0x28 0x28 0x28 0x28>;
						qcom,partial-update-enabled = "single_roi";
						qcom,video-to-cmd-mode-post-switch-commands = [15 01 00 00 00 00 02 b0 00 29 01 00 00 00 00 05 b7 40 00 00 00];
						qcom,video-to-cmd-mode-post-switch-commands-state = "dsi_lp_mode";
					};

					timing@1 {
						qcom,cmd-to-video-mode-post-switch-commands = [15 01 00 00 00 00 02 b0 00 29 01 00 00 00 00 05 b7 51 00 00 00];
						qcom,cmd-to-video-mode-post-switch-commands-state = "dsi_lp_mode";
						qcom,default-topology-index = <0x0>;
						qcom,display-topology = <0x1 0x0 0x1>;
						qcom,mdss-dsi-h-back-porch = <0x28>;
						qcom,mdss-dsi-h-front-porch = <0x28>;
						qcom,mdss-dsi-h-pulse-width = <0x14>;
						qcom,mdss-dsi-h-sync-skew = <0x0>;
						qcom,mdss-dsi-off-command = [05 01 00 00 32 00 02 28 00 05 01 00 00 96 00 02 10 00];
						qcom,mdss-dsi-off-command-state = "dsi_hs_mode";
						qcom,mdss-dsi-on-command = [29 01 00 00 00 00 02 b0 00 29 01 00 00 00 00 0d b6 30 6b 00 06 03 0a 13 1a 6c 18 19 02 29 01 00 00 00 00 05 b7 51 00 00 00 29 01 00 00 00 00 08 b8 57 3d 19 be 1e 0a 0a 29 01 00 00 00 00 08 b9 6f 3d 28 be 3c 14 0a 29 01 00 00 00 00 08 ba b5 33 41 be 64 23 0a 29 01 00 00 00 00 0c bb 44 26 c3 1f 19 06 03 c0 00 00 10 29 01 00 00 00 00 0c bc 32 4c c3 52 32 1f 03 f2 00 00 13 29 01 00 00 00 00 0c bd 24 68 c3 aa 3f 32 03 ff 00 00 25 29 01 00 00 00 00 0d be 00 00 00 00 00 00 00 00 00 00 00 00 29 01 00 00 00 00 0d c0 00 dc 00 dc 04 08 e8 00 04 00 03 78 29 01 00 00 00 00 24 c1 30 00 00 11 11 00 00 00 22 00 05 20 fa 00 08 00 00 00 00 00 00 00 00 00 00 00 00 00 00 00 00 00 00 00 00 29 01 00 00 00 00 79 c2 06 e0 6e 01 03 00 02 00 00 00 00 00 00 00 00 00 00 00 00 00 00 00 00 00 00 00 00 00 00 00 00 00 00 00 00 00 00 00 00 00 00 11 00 00 00 00 04 a0 c9 00 00 00 00 00 00 48 eb 00 00 01 00 00 00 11 00 00 00 00 00 00 00 00 00 00 00 00 00 00 00 00 00 00 00 00 11 00 00 00 00 00 00 dc 00 00 00 00 04 00 08 ef 00 00 00 00 00 11 00 00 00 00 00 00 00 00 00 00 00 00 00 00 29 01 00 00 00 00 6d c3 00 00 00 00 00 00 00 00 00 00 00 00 00 00 00 00 00 00 00 00 00 00 00 00 00 00 00 00 00 00 00 00 00 00 00 00 00 00 00 00 00 00 00 00 00 00 00 00 00 00 00 00 00 00 00 00 00 00 00 00 00 00 aa aa aa 00 00 00 00 00 00 00 00 00 00 00 00 00 00 00 00 00 00 00 00 00 00 00 00 00 00 00 00 00 00 00 00 00 00 00 00 00 00 00 00 00 00 00 29 01 00 00 00 00 62 c4 00 4c 00 3f 00 83 00 00 87 86 85 84 00 00 00 00 00 61 5d 5f 00 5e 60 62 00 00 00 02 00 83 00 00 87 86 85 84 00 00 00 00 00 61 5d 5f 00 5e 60 62 ff ff ff ff ff ff 00 0f 0e 00 0f 0e 00 00 00 00 00 00 00 0f ee 00 0f ee 00 00 e0 00 00 e0 0e 00 00 00 0e 00 00 00 00 00 ff 57 00 00 00 00 00 00 00 29 01 00 00 00 00 06 c5 08 00 00 00 00 29 01 00 00 00 00 3a c6 02 0a 08 fc ff ff ff 00 00 13 01 f0 0c 06 01 43 43 43 00 00 00 01 77 09 28 28 06 01 43 43 43 00 00 00 01 61 00 00 00 1c 01 00 00 00 00 00 00 00 00 00 00 00 00 20 20 00 00 29 01 00 00 00 00 4d c7 00 00 00 e0 01 e9 02 7e 02 05 02 90 02 f6 02 40 02 5c 02 77 02 c8 02 1b 02 5b 02 bd 02 27 02 c3 03 54 03 d8 03 ff 00 00 00 e0 01 e9 02 7e 02 05 02 90 02 f6 02 40 02 5c 02 77 02 c8 02 1b 02 5b 02 bd 02 27 02 c3 03 54 03 d8 03 ff 29 01 00 00 00 00 42 c8 41 00 ff fa 00 ff 00 00 fe f6 fe e9 00 00 ff f7 fb e1 00 00 00 00 00 ff 00 00 ff fa 00 ff 00 fe f6 fe e9 00 ff f7 fb e1 00 00 00 00 ff 00 ff fa 00 ff 00 fe f6 fe e9 00 ff f7 fb e1 00 00 00 00 ff 29 01 00 00 00 00 19 c9 00 ff fa 00 ff 00 00 fe f6 fe e9 00 00 ff f7 fb e1 00 00 00 00 00 ff 00 29 01 00 00 00 00 42 ca 1c fc fc fc 00 00 00 00 00 00 00 00 00 00 00 00 00 00 00 00 00 00 00 00 00 00 00 00 00 00 00 00 00 00 00 00 00 00 00 00 00 00 00 00 00 00 00 00 00 00 00 00 00 00 00 00 00 00 00 00 00 00 00 00 00 29 01 00 00 00 00 0b cc 00 00 4d 8b 55 4d 8b aa 4d 8b 29 01 00 00 00 00 02 cd 00 29 01 00 00 00 00 24 ce 5d 40 49 53 59 5e 63 68 6e 74 7e 8a 98 a8 bb d0 e7 ff 04 00 04 04 42 04 69 5a 40 11 f4 00 00 84 fa 00 00 29 01 00 00 00 00 07 cf 00 00 80 46 61 00 29 01 00 00 00 00 12 d0 f6 95 11 b1 55 cf 00 f6 d3 11 f0 01 12 cf 02 20 11 29 01 00 00 00 00 23 d1 d3 d3 33 33 07 03 3b 33 77 37 77 37 35 77 07 77 f7 33 73 07 33 33 03 33 1b 03 32 3d 0a 30 13 13 20 00 29 01 00 00 00 00 05 d2 00 00 07 00 29 01 00 00 00 00 9a d3 03 00 00 00 00 00 00 0f 00 57 00 00 32 00 00 1a 70 01 19 80 01 01 f0 02 00 e0 06 ff f7 ff ff f7 ff ff f7 ff ff f7 ff ff f7 ff ff f7 ff ff f7 ff ff f7 ff ff f7 ff ff f7 ff ff f7 ff ff f7 ff ff f7 ff ff f7 ff ff f7 ff ff f7 ff ff f7 ff ff f7 ff ff f7 ff ff f7 ff ff f7 ff ff f7 ff ff f7 ff ff f7 ff ff f7 ff ff f7 ff ff f7 ff ff f7 ff ff f7 ff ff f7 ff ff f7 ff ff f7 ff ff f7 ff ff f7 ff ff f7 ff ff f7 ff ff f7 ff ff f7 ff ff f7 ff ff f7 ff ff f7 ff ff f7 ff 29 01 00 00 00 00 05 e5 03 00 00 00 29 01 00 00 00 00 09 d5 02 42 02 42 02 dc 02 dc 29 01 00 00 00 00 02 d6 c0 29 01 00 00 00 00 32 d7 21 10 52 52 00 b6 04 fd 00 b6 04 fd 00 82 80 83 84 85 83 80 84 45 85 85 85 87 04 06 02 04 04 07 10 0c 0b 0a 0a 07 06 00 08 00 00 00 00 00 00 00 00 29 01 00 00 00 00 05 dd 30 06 23 65 29 01 00 00 00 00 0d de 00 00 00 0f ff 00 00 00 00 00 00 10 29 01 00 00 00 00 02 e3 ff 29 01 00 00 00 00 07 e6 00 00 00 00 00 00 29 01 00 00 00 00 0b e7 50 04 00 00 00 00 00 00 00 00 29 01 00 00 00 00 05 e8 00 01 23 00 29 01 00 00 00 00 1e ea 01 02 47 80 47 00 00 00 05 00 12 60 02 47 80 47 00 00 00 00 13 60 00 11 00 30 10 21 02 29 01 00 00 00 00 08 eb 00 00 00 00 01 00 11 29 01 00 00 00 00 04 ec 00 00 00 29 01 00 00 00 00 21 ed 01 01 02 02 02 02 00 00 00 00 00 00 0a 00 00 00 00 10 00 18 00 18 00 b0 00 00 00 00 00 da 10 00 29 01 00 00 00 00 61 ee 03 0f 00 00 00 00 40 1f 00 00 0f f2 3f 00 00 00 00 00 00 00 00 00 00 00 00 00 00 00 10 01 00 09 01 8c d8 ef 00 00 00 00 00 00 00 00 00 00 00 00 00 00 00 00 00 00 50 1f 00 00 00 00 00 00 00 00 00 00 00 00 00 00 00 00 00 00 00 00 00 00 00 00 00 00 00 00 00 00 00 00 00 00 00 00 00 00 00 00 29 01 00 00 00 00 8c ef 00 70 4a 08 d0 00 00 00 00 3c 3c 3c 00 00 00 00 00 00 00 00 00 00 00 00 00 00 00 00 70 4a 08 d0 00 00 00 00 3c 3c 3c 00 00 00 00 00 00 00 00 00 00 00 00 00 00 00 00 00 00 00 00 00 00 00 00 00 00 00 00 00 00 00 00 00 00 00 00 00 00 00 00 00 00 00 00 00 00 00 00 00 00 00 00 00 03 08 ec 50 10 00 10 00 0a 0a 00 00 00 00 10 0f 00 03 51 00 50 00 00 00 00 00 00 00 00 00 00 00 00 00 00 00 00 00 00 00 00 00 00 00 03 08 ec 29 01 00 00 00 00 02 b0 03 29 01 00 00 00 00 02 b0 04 29 01 00 00 00 00 02 d6 00 39 01 00 00 00 00 03 51 ff f0 39 01 00 00 00 00 02 53 0c 39 01 00 00 00 00 02 55 00 39 01 00 00 00 00 02 35 00 39 01 00 00 00 00 05 2a 00 00 04 37 39 01 00 00 00 00 05 2b 00 00 08 e7 05 01 00 00 ff 00 02 29 00 05 01 00 00 ff 00 02 11 00];
						qcom,mdss-dsi-on-command-state = "dsi_lp_mode";
						qcom,mdss-dsi-panel-framerate = <0x3c>;
						qcom,mdss-dsi-panel-height = <0x8e8>;
						qcom,mdss-dsi-panel-phy-timings = [00 21 08 08 25 22 09 08 09 02 04 00 1d 18];
						qcom,mdss-dsi-panel-width = <0x438>;
						qcom,mdss-dsi-v-back-porch = <0x6>;
						qcom,mdss-dsi-v-front-porch = <0xa>;
						qcom,mdss-dsi-v-pulse-width = <0x2>;
						qcom,mdss-dsi-video-mode;
					};
				};
			};
		};
	};

	fragment@1 {
		target = <0xffffffff>;

		__overlay__ {

			qcom,mdss_dsi_td4330_truly_v2_video {
				phandle = <0x15>;
				qcom,dsi-ctrl-num = <0x0>;
				qcom,dsi-phy-num = <0x0>;
				qcom,mdss-dsi-bl-max-level = <0x7ff>;
				qcom,mdss-dsi-bl-min-level = <0x1>;
				qcom,mdss-dsi-bl-pmic-control-type = "bl_ctrl_dcs";
				qcom,mdss-dsi-bllp-eof-power-mode;
				qcom,mdss-dsi-bllp-power-mode;
				qcom,mdss-dsi-border-color = <0x0>;
				qcom,mdss-dsi-bpp = <0x18>;
				qcom,mdss-dsi-color-order = "rgb_swap_rgb";
				qcom,mdss-dsi-dma-trigger = "trigger_sw";
				qcom,mdss-dsi-h-left-border = <0x0>;
				qcom,mdss-dsi-h-right-border = <0x0>;
				qcom,mdss-dsi-h-sync-pulse = <0x0>;
				qcom,mdss-dsi-lane-0-state;
				qcom,mdss-dsi-lane-1-state;
				qcom,mdss-dsi-lane-2-state;
				qcom,mdss-dsi-lane-3-state;
				qcom,mdss-dsi-lane-map = "lane_map_0123";
				qcom,mdss-dsi-lp11-init;
				qcom,mdss-dsi-mdp-trigger = "none";
				qcom,mdss-dsi-panel-name = "td4330 v2 video mode dsi truly panel";
				qcom,mdss-dsi-panel-physical-type = "oled";
				qcom,mdss-dsi-panel-type = "dsi_video_mode";
				qcom,mdss-dsi-reset-sequence = <0x1 0xa 0x0 0xa 0x1 0xa>;
				qcom,mdss-dsi-stream = <0x0>;
				qcom,mdss-dsi-te-check-enable;
				qcom,mdss-dsi-te-dcs-command = <0x1>;
				qcom,mdss-dsi-te-pin-select = <0x1>;
				qcom,mdss-dsi-te-using-te-pin;
				qcom,mdss-dsi-traffic-mode = "burst_mode";
				qcom,mdss-dsi-tx-eot-append;
				qcom,mdss-dsi-underflow-color = <0xff>;
				qcom,mdss-dsi-v-bottom-border = <0x0>;
				qcom,mdss-dsi-v-top-border = <0x0>;
				qcom,mdss-dsi-virtual-channel-id = <0x0>;
				qcom,mdss-dsi-wr-mem-continue = <0x3c>;
				qcom,mdss-dsi-wr-mem-start = <0x2c>;
				qcom,mdss-pan-physical-height-dimension = <0x95>;
				qcom,mdss-pan-physical-width-dimension = <0x43>;

				qcom,mdss-dsi-display-timings {

					timing@0 {
						qcom,mdss-dsi-h-back-porch = <0x44>;
						qcom,mdss-dsi-h-front-porch = <0x5c>;
						qcom,mdss-dsi-h-pulse-width = <0x10>;
						qcom,mdss-dsi-h-sync-skew = <0x0>;
						qcom,mdss-dsi-off-command = [05 01 00 00 00 00 02 28 00 05 01 00 00 96 00 02 10 00];
						qcom,mdss-dsi-off-command-state = "dsi_hs_mode";
						qcom,mdss-dsi-on-command = <0x39000000 0x5f1 0x5a5a5a5a 0x39000000 0x5b0 0x3c201 0x39000000 0x2c2 0x44390000 0x5 0xb00001d8 0x1390000 0x2 0xd8013900 0x6400 0x5f1a5a5 0xa5a50501 0x1400 0x2110039 0x0 0x5f15a 0x5a5a5a39 0x0 0x5b000 0x3c20139 0x0 0x2c211 0x39000000 0x5f1 0xa5a5a5a5 0x39000000 0x5f1 0x5a5a5a5a 0x39000000 0x260 0x21390000 0x2 0xf7073900 0x0 0x5f1a5a5 0xa5a53900 0x1400 0x5f15a5a 0x5a5a3900 0x0 0x5b0002c 0x3900 0x0 0x11e00003 0xc2078503 0x39056d05 0x5106c312 0x9e443900 0x0 0x5b00041 0x3900 0x0 0x2e01339 0x0 0x5f1a5 0xa5a5a539 0x0 0x5f15a 0x5a5a5a39 0x0 0x3b201 0x31390000 0x5 0xf1a5a5a5 0xa5390000 0x5 0xf15a5a5a 0x5a390000 0x5 0xb0000db2 0x1390000 0x2 0xb2203900 0x0 0x5b0000c 0xb2013900 0x0 0x2b23039 0x0 0x5f1a5 0xa5a5a539 0x0 0x25320 0x39000000 0x351 0x7ff3900 0x7800 0x2f70705 0x100000a 0x22900>;
						qcom,mdss-dsi-on-command-state = "dsi_lp_mode";
						qcom,mdss-dsi-panel-framerate = <0x3c>;
						qcom,mdss-dsi-panel-height = <0x960>;
						qcom,mdss-dsi-panel-width = <0x438>;
						qcom,mdss-dsi-v-back-porch = <0xa>;
						qcom,mdss-dsi-v-front-porch = <0x14>;
						qcom,mdss-dsi-v-pulse-width = <0x2>;
					};
				};
			};
		};
	};

	fragment@10 {
		target = <0xffffffff>;

		__overlay__ {

			pm7250b-bcl-lvl0 {
				polling-delay = <0x0>;
				polling-delay-passive = <0x64>;
				thermal-governor = "step_wise";
				thermal-sensors = <0xd 0x5>;
				wake-capable-sensor;

				trips {

					b-bcl-lvl0 {
						hysteresis = <0x1>;
						phandle = <0x27>;
						temperature = <0x1>;
						type = "passive";
					};
				};
			};

			pm7250b-bcl-lvl1 {
				polling-delay = <0x0>;
				polling-delay-passive = <0x64>;
				thermal-governor = "step_wise";
				thermal-sensors = <0xd 0x6>;
				wake-capable-sensor;

				trips {

					b-bcl-lvl1 {
						hysteresis = <0x1>;
						phandle = <0x28>;
						temperature = <0x1>;
						type = "passive";
					};
				};
			};

			pm7250b-bcl-lvl2 {
				polling-delay = <0x0>;
				polling-delay-passive = <0x64>;
				thermal-governor = "step_wise";
				thermal-sensors = <0xd 0x7>;
				wake-capable-sensor;

				trips {

					b-bcl-lvl2 {
						hysteresis = <0x1>;
						phandle = <0x29>;
						temperature = <0x1>;
						type = "passive";
					};
				};
			};

			pm7250b-ibat-lvl0 {
				polling-delay = <0x0>;
				polling-delay-passive = <0x0>;
				thermal-governor = "step_wise";
				thermal-sensors = <0xd 0x0>;
				wake-capable-sensor;

				trips {

					ibat-lvl0 {
						hysteresis = <0xc8>;
						phandle = <0x22>;
						temperature = <0x157c>;
						type = "passive";
					};
				};
			};

			pm7250b-ibat-lvl1 {
				polling-delay = <0x0>;
				polling-delay-passive = <0x0>;
				thermal-governor = "step_wise";
				thermal-sensors = <0xd 0x1>;
				wake-capable-sensor;

				trips {

					ibat-lvl1 {
						hysteresis = <0xc8>;
						phandle = <0x23>;
						temperature = <0x1770>;
						type = "passive";
					};
				};
			};

			pm7250b-tz {
				phandle = <0x1f>;
				polling-delay = <0x0>;
				polling-delay-passive = <0x64>;
				thermal-governor = "step_wise";
				thermal-sensors = <0xc>;
				wake-capable-sensor;

				trips {

					trip0 {
						hysteresis = <0x0>;
						phandle = <0x20>;
						temperature = <0x17318>;
						type = "passive";
					};

					trip1 {
						hysteresis = <0x0>;
						phandle = <0x21>;
						temperature = <0x1c138>;
						type = "passive";
					};

					trip2 {
						hysteresis = <0x0>;
						temperature = <0x23668>;
						type = "passive";
					};
				};
			};

			pm7250b-vbat-lvl0 {
				polling-delay = <0x0>;
				polling-delay-passive = <0x0>;
				thermal-governor = "low_limits_cap";
				thermal-sensors = <0xd 0x2>;
				tracks-low;
				wake-capable-sensor;

				trips {

					vbat-lvl0 {
						hysteresis = <0xc8>;
						phandle = <0x24>;
						temperature = <0xbb8>;
						type = "passive";
					};
				};
			};

			pm7250b-vbat-lvl1 {
				polling-delay = <0x0>;
				polling-delay-passive = <0x0>;
				thermal-governor = "low_limits_cap";
				thermal-sensors = <0xd 0x3>;
				tracks-low;
				wake-capable-sensor;

				trips {

					vbat-lvl1 {
						hysteresis = <0xc8>;
						phandle = <0x25>;
						temperature = <0xaf0>;
						type = "passive";
					};
				};
			};

			pm7250b-vbat-lvl2 {
				polling-delay = <0x0>;
				polling-delay-passive = <0x0>;
				thermal-governor = "low_limits_cap";
				thermal-sensors = <0xd 0x4>;
				tracks-low;
				wake-capable-sensor;

				trips {

					vbat-lvl2 {
						hysteresis = <0xc8>;
						phandle = <0x26>;
						temperature = <0xa28>;
						type = "passive";
					};
				};
			};

			soc {
				polling-delay = <0x0>;
				polling-delay-passive = <0x64>;
				thermal-governor = "low_limits_cap";
				thermal-sensors = <0xe>;
				tracks-low;
				wake-capable-sensor;

				trips {

					soc-trip {
						hysteresis = <0x0>;
						phandle = <0x2a>;
						temperature = <0xa>;
						type = "passive";
					};
				};
			};
		};
	};

	fragment@11 {
		target = <0xffffffff>;

		__overlay__ {

			charger-therm-usr {
				polling-delay = <0x0>;
				polling-delay-passive = <0x0>;
				thermal-governor = "user_space";
				thermal-sensors = <0xf 0x4d>;
				wake-capable-sensor;

				trips {

					active-config0 {
						hysteresis = <0x3e8>;
						temperature = <0x1e848>;
						type = "passive";
					};
				};
			};

			conn-therm-usr {
				polling-delay = <0x0>;
				polling-delay-passive = <0x0>;
				thermal-governor = "user_space";
				thermal-sensors = <0xf 0x4f>;
				wake-capable-sensor;

				trips {

					active-config0 {
						hysteresis = <0x3e8>;
						temperature = <0x1e848>;
						type = "passive";
					};
				};
			};
		};
	};

	fragment@12 {
		target = <0xffffffff>;

		__overlay__ {

			eldo9_pin {

				gpio@c000 {
					bias-disable;
					function = "normal";
					output-high;
					phandle = <0x10>;
					pins = "gpio1";
					power-source = <0x0>;
					qcom,drive-strength = <0x2>;
				};
			};
		};
	};

	fragment@13 {
		target = <0xffffffff>;

		__overlay__ {

			vdda_usb_ss_dp_core {
				compatible = "regulator-fixed";
				enable-active-high;
				gpio = <0xffffffff 0x1 0x0>;
				phandle = <0x11>;
				pinctrl-0 = <0x10>;
				pinctrl-names = "default";
				regulator-max-microvolt = <0xd6d80>;
				regulator-min-microvolt = <0xd6d80>;
				regulator-name = "vdd_supply";
			};
		};
	};

	fragment@14 {
		target = <0xffffffff>;

		__overlay__ {
			pinctrl-0 = <0xffffffff 0xffffffff 0xffffffff 0xffffffff>;
			pinctrl-1 = <0xffffffff 0xffffffff 0xffffffff 0xffffffff>;
			pinctrl-names = "active", "sleep";
			qcom,vdd-current-level = <0x0 0x8b290>;
			qcom,vdd-io-always-on;
			qcom,vdd-io-current-level = <0x0 0x4f588>;
			qcom,vdd-io-lpm-sup;
			qcom,vdd-io-voltage-level = <0x1b7740 0x1b7740>;
			qcom,vdd-voltage-level = <0x2d2a80 0x2d2a80>;
			status = "ok";
			vdd-io-supply = <0xffffffff>;
			vdd-supply = <0xffffffff>;
		};
	};

	fragment@15 {
		target = <0xffffffff>;

		__overlay__ {
			cd-gpios = <0xffffffff 0x58 0x1>;
			pinctrl-0 = <0xffffffff 0xffffffff 0xffffffff 0xffffffff>;
			pinctrl-1 = <0xffffffff 0xffffffff 0xffffffff 0xffffffff>;
			pinctrl-names = "active", "sleep";
			qcom,vdd-current-level = <0x0 0xc3500>;
			qcom,vdd-io-bias-current-level = <0x0 0x1770>;
			qcom,vdd-io-bias-voltage-level = <0x132a40 0x132a40>;
			qcom,vdd-io-current-level = <0x0 0x55f0>;
			qcom,vdd-io-voltage-level = <0x1b7740 0x2d2a80>;
			qcom,vdd-voltage-level = <0x2d2a80 0x2d2a80>;
			status = "ok";
			vdd-io-bias-supply = <0xffffffff>;
			vdd-io-supply = <0xffffffff>;
			vdd-supply = <0xffffffff>;
		};
	};

	fragment@16 {
		target = <0xffffffff>;

		__overlay__ {
			compatible = "qcom,ufs-phy-qmp-v4";
			status = "ok";
			vdda-phy-max-microamp = <0x14ec4>;
			vdda-phy-supply = <0xffffffff>;
			vdda-pll-max-microamp = <0x477c>;
			vdda-pll-supply = <0xffffffff>;
		};
	};

	fragment@17 {
		target = <0xffffffff>;

		__overlay__ {
			qcom,vddp-ref-clk-max-microamp = <0x64>;
			qcom,vddp-ref-clk-max-uV = <0x12cc80>;
			qcom,vddp-ref-clk-min-uV = <0x12cc80>;
			qcom,vddp-ref-clk-supply = <0xffffffff>;
			status = "ok";
			vcc-max-microamp = <0xc3500>;
			vcc-supply = <0xffffffff>;
			vcc-voltage-level = <0x2d0370 0x2d2a80>;
			vccq2-max-microamp = <0xc3500>;
			vccq2-pwr-collapse-sup;
			vccq2-supply = <0xffffffff>;
			vccq2-voltage-level = <0x1b7740 0x1b7740>;
			vdd-hba-fixed-regulator;
			vdd-hba-supply = <0xffffffff>;
		};
	};

	fragment@18 {
		target = <0xffffffff>;

		__overlay__ {
			vdd-supply = <0x11>;
		};
	};

	fragment@19 {
		target = <0xffffffff>;

		__overlay__ {
			pinctrl-0 = <0xffffffff 0xffffffff 0x12>;

			rf_pa1_therm {
				label = "rf_pa1_therm";
				qcom,hw-settle-time = <0xc8>;
				qcom,pre-scaling = <0x1 0x1>;
				qcom,ratiometric;
				reg = <0x55>;
			};
		};
	};

	fragment@2 {
		target = <0xffffffff>;

		__overlay__ {

			qcom,mdss_dsi_panel_k7_38_0c_0a_fhdp_video {
				phandle = <0x16>;
				qcom,dispparam-enabled;
				qcom,dsi-ctrl-num = <0x0>;
				qcom,dsi-phy-num = <0x0>;
				qcom,dsi-select-clocks = "mux_byte_clk0", "mux_pixel_clk0", "src_byte_clk0", "src_pixel_clk0", "shadow_byte_clk0", "shadow_pixel_clk0";
				qcom,dsi-supported-dfps-list = <0x5a 0x3c>;
				qcom,esd-check-enabled;
				qcom,esd-err-irq-gpio = <0xffffffff 0x63 0x2001>;
				qcom,mdss-brightness-max-level = <0x7ff>;
				qcom,mdss-dsi-bl-inverted-dbv;
				qcom,mdss-dsi-bl-max-level = <0x7ff>;
				qcom,mdss-dsi-bl-min-level = <0x1>;
				qcom,mdss-dsi-bl-pmic-control-type = "bl_ctrl_dcs";
				qcom,mdss-dsi-bllp-eof-power-mode;
				qcom,mdss-dsi-bllp-power-mode;
				qcom,mdss-dsi-border-color = <0x0>;
				qcom,mdss-dsi-bpp = <0x18>;
				qcom,mdss-dsi-color-order = "rgb_swap_rgb";
				qcom,mdss-dsi-dma-trigger = "trigger_sw";
				qcom,mdss-dsi-h-left-border = <0x0>;
				qcom,mdss-dsi-h-right-border = <0x0>;
				qcom,mdss-dsi-h-sync-pulse = <0x0>;
				qcom,mdss-dsi-lane-0-state;
				qcom,mdss-dsi-lane-1-state;
				qcom,mdss-dsi-lane-2-state;
				qcom,mdss-dsi-lane-3-state;
				qcom,mdss-dsi-lane-map = "lane_map_0123";
				qcom,mdss-dsi-lp11-init;
				qcom,mdss-dsi-mdp-trigger = "none";
				qcom,mdss-dsi-pan-enable-dynamic-fps;
				qcom,mdss-dsi-pan-fps-update = "dfps_immediate_porch_mode_vfp";
				qcom,mdss-dsi-panel-model = "xiaomi 38 0c 0a VIDEO PANEL";
				qcom,mdss-dsi-panel-name = "k7 38 0c 0a video mode fhdp dsi panel";
				qcom,mdss-dsi-panel-on-check-value = <0x9d>;
				qcom,mdss-dsi-panel-physical-type = "oled";
				qcom,mdss-dsi-panel-status-check-mode = "reg_read";
				qcom,mdss-dsi-panel-status-command = <0x6010001 0x10a>;
				qcom,mdss-dsi-panel-status-command-state = "dsi_hs_mode";
				qcom,mdss-dsi-panel-status-read-length = <0x1>;
				qcom,mdss-dsi-panel-status-value = <0x9d>;
				qcom,mdss-dsi-panel-type = "dsi_video_mode";
				qcom,mdss-dsi-qsync-max-refresh-rate = <0x5a>;
				qcom,mdss-dsi-qsync-min-refresh-rate = <0x3c>;
				qcom,mdss-dsi-reset-sequence = <0x1 0xa 0x0 0xa 0x1 0xa>;
				qcom,mdss-dsi-stream = <0x0>;
				qcom,mdss-dsi-te-check-enable;
				qcom,mdss-dsi-te-dcs-command = <0x1>;
				qcom,mdss-dsi-te-pin-select = <0x1>;
				qcom,mdss-dsi-te-using-te-pin;
				qcom,mdss-dsi-traffic-mode = "burst_mode";
				qcom,mdss-dsi-tx-eot-append;
				qcom,mdss-dsi-underflow-color = <0xff>;
				qcom,mdss-dsi-v-bottom-border = <0x0>;
				qcom,mdss-dsi-v-top-border = <0x0>;
				qcom,mdss-dsi-virtual-channel-id = <0x0>;
				qcom,mdss-dsi-wr-mem-continue = <0x3c>;
				qcom,mdss-dsi-wr-mem-start = <0x2c>;
				qcom,mdss-pan-physical-height-dimension = <0x95>;
				qcom,mdss-pan-physical-width-dimension = <0x43>;
				qcom,platform-en-gpio = <0xffffffff 0x9 0x0>;

				qcom,mdss-dsi-display-timings {

					timing@0 {
						qcom,compression-mode = "dsc";
						qcom,default-topology-index = <0x0>;
						qcom,display-topology = <0x1 0x1 0x1>;
						qcom,mdss-dsc-bit-per-component = <0x8>;
						qcom,mdss-dsc-bit-per-pixel = <0x8>;
						qcom,mdss-dsc-block-prediction-enable;
						qcom,mdss-dsc-slice-height = <0x14>;
						qcom,mdss-dsc-slice-per-pkt = <0x1>;
						qcom,mdss-dsc-slice-width = <0x21c>;
						qcom,mdss-dsi-dispparam-bc-60hz-command = [39 00 00 00 00 00 03 f1 5a 5a 39 00 00 00 00 00 02 60 21 39 00 00 00 00 00 02 f7 07 39 01 00 00 00 00 03 f1 a5 a5];
						qcom,mdss-dsi-dispparam-bc-60hz-command-state = "dsi_hs_mode";
						qcom,mdss-dsi-dispparam-bc-90hz-command = [39 00 00 00 00 00 03 f1 5a 5a 39 00 00 00 00 00 02 60 01 39 00 00 00 00 00 02 f7 07 39 01 00 00 00 00 03 f1 a5 a5];
						qcom,mdss-dsi-dispparam-bc-90hz-command-state = "dsi_hs_mode";
						qcom,mdss-dsi-dispparam-hbm-off-command = [39 01 00 00 00 00 02 53 30];
						qcom,mdss-dsi-dispparam-hbm-off-command-state = "dsi_lp_mode";
						qcom,mdss-dsi-dispparam-hbm-on-command = [39 01 00 00 00 00 02 53 f0 39 01 00 00 00 00 03 51 07 ff];
						qcom,mdss-dsi-dispparam-hbm-on-command-state = "dsi_lp_mode";
						qcom,mdss-dsi-doze-hbm-command = [39 01 00 00 00 00 03 51 01 0e];
						qcom,mdss-dsi-doze-hbm-command-state = "dsi_lp_mode";
						qcom,mdss-dsi-doze-lbm-command = [39 01 00 00 00 00 03 51 00 14];
						qcom,mdss-dsi-doze-lbm-command-state = "dsi_lp_mode";
						qcom,mdss-dsi-flat-off-command = [39 01 00 00 00 00 03 f1 5a 5a 39 01 00 00 00 00 05 b0 00 88 b1 01 39 01 00 00 00 00 03 b1 27 0d 39 01 00 00 00 00 03 f1 a5 a5];
						qcom,mdss-dsi-flat-off-command-state = "dsi_lp_mode";
						qcom,mdss-dsi-flat-on-command = [39 01 00 00 00 00 03 f1 5a 5a 39 01 00 00 00 00 05 b0 00 88 b1 01 39 01 00 00 00 00 03 b1 27 2d 39 01 00 00 00 00 03 f1 a5 a5];
						qcom,mdss-dsi-flat-on-command-state = "dsi_lp_mode";
						qcom,mdss-dsi-h-back-porch = <0x78>;
						qcom,mdss-dsi-h-front-porch = <0x140>;
						qcom,mdss-dsi-h-pulse-width = <0x20>;
						qcom,mdss-dsi-h-sync-skew = <0x0>;
						qcom,mdss-dsi-hbm1-on-command-state = "dsi_lp_mode";
						qcom,mdss-dsi-hbm2-on-command-state = "dsi_lp_mode";
						qcom,mdss-dsi-off-command = <0x5010000 0xa000128 0x5010000 0x96000110>;
						qcom,mdss-dsi-off-command-state = "dsi_lp_mode";
						qcom,mdss-dsi-on-command = [05 01 00 00 14 00 01 11 39 01 00 00 00 00 05 f1 5a 5a 5a 5a 39 01 00 00 00 00 05 b0 00 2c e0 01 39 01 00 00 00 00 0c e0 00 03 95 07 85 03 39 05 6d 05 51 39 01 00 00 00 00 05 b0 00 41 e0 01 39 01 00 00 00 00 02 e0 03 39 01 00 00 00 00 05 f1 a5 a5 a5 a5 39 01 00 00 00 00 03 f1 5a 5a 39 01 00 00 00 00 03 b2 01 30 39 01 00 00 00 00 03 f1 a5 a5 39 01 00 00 00 00 05 f1 5a 5a 5a 5a 39 01 00 00 00 00 05 b0 00 08 ea 01 39 01 00 00 00 00 03 ea f4 89 39 01 00 00 00 00 05 b0 00 0a ea 01 39 01 00 00 00 00 04 ea 55 01 04 39 01 00 00 00 00 05 b0 00 0d ea 01 39 01 00 00 00 00 03 ea ff ff 39 01 00 00 00 00 05 b0 00 74 e1 01 39 01 00 00 00 00 02 e1 3f 39 01 00 00 00 00 05 b0 00 10 ea 01 39 01 00 00 00 00 02 ea 01 39 01 00 00 00 00 05 f1 a5 a5 a5 a5 39 01 00 00 00 00 05 f1 5a 5a 5a 5a 39 01 00 00 00 00 05 b0 00 32 f6 01 39 01 00 00 00 00 06 f6 24 00 19 00 00 39 01 00 00 00 00 05 f1 a5 a5 a5 a5 39 01 00 00 00 00 03 f1 5a 5a 39 01 00 00 00 00 04 b0 00 09 cd 39 01 00 00 00 00 04 cd 08 48 20 39 01 00 00 00 00 03 f1 a5 a5 39 01 00 00 00 00 02 9d 01 39 01 00 00 00 00 5a 9e 11 00 00 89 30 80 09 60 04 38 00 28 02 1c 02 1c 02 00 02 0e 00 20 03 dd 00 07 00 0c 02 77 02 8b 18 00 10 f0 03 0c 20 00 06 0b 0b 33 0e 1c 2a 38 46 54 62 69 70 77 79 7b 7d 7e 01 02 01 00 09 40 09 be 19 fc 19 fa 19 f8 1a 38 1a 78 1a b6 2a f6 2b 34 2b 74 3b 74 6b f4 00 39 01 00 00 00 00 03 f1 5a 5a 39 01 00 00 00 00 02 60 21 39 01 00 00 00 00 02 f7 07 39 01 00 00 00 00 03 f1 a5 a5 39 01 00 00 00 00 03 f1 5a 5a 39 01 00 00 00 00 05 b0 00 0d b2 01 39 01 00 00 00 00 02 b2 20 39 01 00 00 00 00 05 b0 00 0c b2 01 39 01 00 00 00 00 02 b2 30 39 01 00 00 00 00 03 f1 a5 a5 39 01 00 00 00 00 02 53 30 39 01 00 00 64 00 02 f7 07 05 01 00 00 00 00 01 29];
						qcom,mdss-dsi-on-command-state = "dsi_lp_mode";
						qcom,mdss-dsi-panel-framerate = <0x5a>;
						qcom,mdss-dsi-panel-height = <0x960>;
						qcom,mdss-dsi-panel-phy-timings = [00 24 09 0a 1a 25 09 0a 09 02 04 00 1e 0f];
						qcom,mdss-dsi-panel-width = <0x438>;
						qcom,mdss-dsi-v-back-porch = <0xa>;
						qcom,mdss-dsi-v-front-porch = <0x14>;
						qcom,mdss-dsi-v-pulse-width = <0x2>;
					};
				};
			};
		};
	};

	fragment@20 {
		target = <0xffffffff>;

		__overlay__ {
			io-channels = <0xffffffff 0x4d 0xffffffff 0x4e 0xffffffff 0x4c 0xffffffff 0x55>;

			rf_pa1_therm {
				qcom,hw-settle-time = <0xc8>;
				qcom,ratiometric;
				reg = <0x55>;
			};
		};
	};

	fragment@21 {
		target = <0xffffffff>;

		__overlay__ {

			rf-pa1-therm-usr {
				polling-delay = <0x0>;
				polling-delay-passive = <0x0>;
				thermal-governor = "user_space";
				thermal-sensors = <0xffffffff 0x55>;
				wake-capable-sensor;

				trips {

					active-config0 {
						hysteresis = <0x3e8>;
						temperature = <0x1e848>;
						type = "passive";
					};
				};
			};
		};
	};

	fragment@22 {
		target = <0xffffffff>;

		__overlay__ {

			key_vol_up {

				key_vol_up_default {
					bias-pull-up;
					function = "normal";
					input-enable;
					phandle = <0x13>;
					pins = "gpio5";
					power-source = <0x0>;
				};
			};

			rf_pa1_therm {

				rf_pa1_therm_default {
					bias-high-impedance;
					phandle = <0x12>;
					pins = "gpio7";
				};
			};
		};
	};

	fragment@23 {
		target = <0xffffffff>;

		__overlay__ {

			gpio_keys {
				compatible = "gpio-keys";
				label = "gpio-keys";
				pinctrl-0 = <0x13>;
				pinctrl-names = "default";

				vol_up {
					debounce-interval = <0xf>;
					gpio-key,wakeup;
					gpios = <0xffffffff 0x5 0x1>;
					label = "volume_up";
					linux,can-disable;
					linux,code = <0x73>;
					linux,input-type = <0x1>;
				};
			};
		};
	};

	fragment@24 {
		target = <0xffffffff>;

		__overlay__ {
			status = "disabled";
		};
	};

	fragment@25 {
		target = <0xffffffff>;

		__overlay__ {
			status = "disabled";
		};
	};

	fragment@26 {
		target = <0xffffffff>;

		__overlay__ {
			status = "okay";
		};
	};

	fragment@27 {
		target = <0xffffffff>;

		__overlay__ {
			qcom,i2c-touch-active = "novatek,NVT-ts";
			status = "okay";

			novatek@62 {
				compatible = "novatek,NVT-ts";
				interrupt-parent = <0xffffffff>;
				interrupts = <0x50 0x2008>;
				novatek,irq-gpio = <0xffffffff 0x50 0x2008>;
				novatek,reset-gpio = <0xffffffff 0x56 0x0>;
				panel = <0x4>;
				pinctrl-0 = <0xffffffff 0xffffffff>;
				pinctrl-1 = <0xffffffff 0xffffffff>;
				pinctrl-2 = <0xffffffff>;
				pinctrl-names = "pmx_ts_active", "pmx_ts_suspend", "pmx_ts_release";
				reg = <0x62>;
				status = "ok";
			};
		};
	};

	fragment@3 {
		target = <0xffffffff>;

		__overlay__ {

			qcom,mdss_dsi_panel_k7_38_0c_0b_fhdp_video {
				phandle = <0x17>;
				qcom,dispparam-enabled;
				qcom,dsi-ctrl-num = <0x0>;
				qcom,dsi-phy-num = <0x0>;
				qcom,dsi-select-clocks = "mux_byte_clk0", "mux_pixel_clk0";
				qcom,dsi-supported-dfps-list = <0x5a 0x3c>;
				qcom,esd-err-irq-gpio = <0xffffffff 0x63 0x2001>;
				qcom,mdss-brightness-max-level = <0x7ff>;
				qcom,mdss-dsi-bl-inverted-dbv;
				qcom,mdss-dsi-bl-max-level = <0x7ff>;
				qcom,mdss-dsi-bl-min-level = <0x1>;
				qcom,mdss-dsi-bl-pmic-control-type = "bl_ctrl_dcs";
				qcom,mdss-dsi-bllp-eof-power-mode;
				qcom,mdss-dsi-bllp-power-mode;
				qcom,mdss-dsi-border-color = <0x0>;
				qcom,mdss-dsi-bpp = <0x18>;
				qcom,mdss-dsi-color-order = "rgb_swap_rgb";
				qcom,mdss-dsi-dma-trigger = "trigger_sw";
				qcom,mdss-dsi-h-left-border = <0x0>;
				qcom,mdss-dsi-h-right-border = <0x0>;
				qcom,mdss-dsi-h-sync-pulse = <0x0>;
				qcom,mdss-dsi-lane-0-state;
				qcom,mdss-dsi-lane-1-state;
				qcom,mdss-dsi-lane-2-state;
				qcom,mdss-dsi-lane-3-state;
				qcom,mdss-dsi-lane-map = "lane_map_0123";
				qcom,mdss-dsi-lp11-init;
				qcom,mdss-dsi-mdp-trigger = "none";
				qcom,mdss-dsi-pan-enable-dynamic-fps;
				qcom,mdss-dsi-pan-fps-update = "dfps_immediate_porch_mode_vfp";
				qcom,mdss-dsi-panel-model = "xiaomi 38 0c 0b VIDEO PANEL";
				qcom,mdss-dsi-panel-name = "k7 38 0c 0b video mode fhdp dsi panel";
				qcom,mdss-dsi-panel-on-check-value = <0x9f>;
				qcom,mdss-dsi-panel-physical-type = "oled";
				qcom,mdss-dsi-panel-status-check-mode = "reg_read";
				qcom,mdss-dsi-panel-status-command = <0x6010001 0x10a>;
				qcom,mdss-dsi-panel-status-command-state = "dsi_hs_mode";
				qcom,mdss-dsi-panel-status-read-length = <0x1>;
				qcom,mdss-dsi-panel-status-value = <0x9f>;
				qcom,mdss-dsi-panel-type = "dsi_video_mode";
				qcom,mdss-dsi-qsync-max-refresh-rate = <0x5a>;
				qcom,mdss-dsi-qsync-min-refresh-rate = <0x3c>;
				qcom,mdss-dsi-reset-sequence = <0x1 0xa 0x0 0xa 0x1 0xa>;
				qcom,mdss-dsi-stream = <0x0>;
				qcom,mdss-dsi-te-check-enable;
				qcom,mdss-dsi-te-dcs-command = <0x1>;
				qcom,mdss-dsi-te-pin-select = <0x1>;
				qcom,mdss-dsi-te-using-te-pin;
				qcom,mdss-dsi-traffic-mode = "burst_mode";
				qcom,mdss-dsi-tx-eot-append;
				qcom,mdss-dsi-underflow-color = <0xff>;
				qcom,mdss-dsi-v-bottom-border = <0x0>;
				qcom,mdss-dsi-v-top-border = <0x0>;
				qcom,mdss-dsi-virtual-channel-id = <0x0>;
				qcom,mdss-dsi-wr-mem-continue = <0x3c>;
				qcom,mdss-dsi-wr-mem-start = <0x2c>;
				qcom,mdss-pan-physical-height-dimension = <0x95>;
				qcom,mdss-pan-physical-width-dimension = <0x43>;
				qcom,platform-en-gpio = <0xffffffff 0x9 0x0>;

				qcom,mdss-dsi-display-timings {

					timing@0 {
						qcom,compression-mode = "dsc";
						qcom,default-topology-index = <0x0>;
						qcom,display-topology = <0x1 0x1 0x1>;
						qcom,mdss-dsc-bit-per-component = <0x8>;
						qcom,mdss-dsc-bit-per-pixel = <0x8>;
						qcom,mdss-dsc-block-prediction-enable;
						qcom,mdss-dsc-slice-height = <0x14>;
						qcom,mdss-dsc-slice-per-pkt = <0x1>;
						qcom,mdss-dsc-slice-width = <0x21c>;
						qcom,mdss-dsi-dispparam-bc-60hz-command = [39 00 00 00 00 00 03 f0 5a 5a 39 00 00 00 00 00 02 60 21 39 00 00 00 00 00 02 f7 0b 39 01 00 00 00 00 03 f0 a5 a5];
						qcom,mdss-dsi-dispparam-bc-60hz-command-state = "dsi_hs_mode";
						qcom,mdss-dsi-dispparam-bc-90hz-command = [39 00 00 00 00 00 03 f0 5a 5a 39 00 00 00 00 00 02 60 01 39 00 00 00 00 00 02 f7 0b 39 01 00 00 00 00 03 f0 a5 a5];
						qcom,mdss-dsi-dispparam-bc-90hz-command-state = "dsi_hs_mode";
						qcom,mdss-dsi-dispparam-hbm-off-command = [39 01 00 00 00 00 02 53 28 39 01 00 00 00 00 02 f7 0b];
						qcom,mdss-dsi-dispparam-hbm-off-command-state = "dsi_lp_mode";
						qcom,mdss-dsi-dispparam-hbm-on-command = <0x39010000 0x253 0xe8390100 0x3 0x5107ff39 0x1000000 0x2f70b>;
						qcom,mdss-dsi-dispparam-hbm-on-command-state = "dsi_lp_mode";
						qcom,mdss-dsi-doze-hbm-command = [39 01 00 00 00 00 03 51 01 0e];
						qcom,mdss-dsi-doze-hbm-command-state = "dsi_lp_mode";
						qcom,mdss-dsi-doze-lbm-command = [39 01 00 00 00 00 03 51 00 14];
						qcom,mdss-dsi-doze-lbm-command-state = "dsi_lp_mode";
						qcom,mdss-dsi-flat-off-command = [39 01 00 00 00 00 03 f0 5a 5a 39 01 00 00 00 00 04 b0 00 88 b1 39 01 00 00 00 00 03 b1 27 0d 39 01 00 00 00 00 03 f0 a5 a5];
						qcom,mdss-dsi-flat-off-command-state = "dsi_hs_mode";
						qcom,mdss-dsi-flat-on-command = [39 01 00 00 00 00 03 f0 5a 5a 39 01 00 00 00 00 04 b0 00 88 b1 39 01 00 00 00 00 03 b1 27 2d 39 01 00 00 00 00 03 f0 a5 a5];
						qcom,mdss-dsi-flat-on-command-state = "dsi_hs_mode";
						qcom,mdss-dsi-h-back-porch = <0x78>;
						qcom,mdss-dsi-h-front-porch = <0x140>;
						qcom,mdss-dsi-h-pulse-width = <0x20>;
						qcom,mdss-dsi-h-sync-skew = <0x0>;
						qcom,mdss-dsi-hbm1-on-command = [39 01 00 00 00 00 02 53 e8 39 01 00 00 00 00 03 51 04 ee];
						qcom,mdss-dsi-hbm1-on-command-state = "dsi_lp_mode";
						qcom,mdss-dsi-hbm2-on-command = [39 01 00 00 00 00 02 53 e8 39 01 00 00 00 00 03 51 07 ff];
						qcom,mdss-dsi-hbm2-on-command-state = "dsi_lp_mode";
						qcom,mdss-dsi-on-command = [05 01 00 00 50 00 02 11 00 39 01 00 00 00 00 03 f0 5a 5a 39 01 00 00 00 00 03 b2 01 31 39 01 00 00 00 00 03 f0 a5 a5 39 01 00 00 00 00 03 f0 5a 5a 39 01 00 00 00 00 03 fc 5a 5a 39 01 00 00 00 00 02 e1 8b 39 01 00 00 00 00 03 ed 00 01 39 01 00 00 00 00 04 b0 00 06 f4 39 01 00 00 00 00 02 f4 1f 39 01 00 00 00 00 03 f0 a5 a5 39 01 00 00 00 00 03 fc a5 a5 39 01 00 00 00 00 03 f0 5a 5a 39 01 00 00 00 00 03 fc 5a 5a 39 01 00 00 00 00 04 b0 00 11 fe 39 01 00 00 00 00 02 fe 00 39 01 00 00 00 00 03 f0 a5 a5 39 01 00 00 00 00 03 fc a5 a5 39 01 00 00 00 00 02 9d 01 39 01 00 00 00 00 5a 9e 11 00 00 89 30 80 09 60 04 38 00 28 02 1c 02 1c 02 00 02 0e 00 20 03 dd 00 07 00 0c 02 77 02 8b 18 00 10 f0 03 0c 20 00 06 0b 0b 33 0e 1c 2a 38 46 54 62 69 70 77 79 7b 7d 7e 01 02 01 00 09 40 09 be 19 fc 19 fa 19 f8 1a 38 1a 78 1a b6 2a f6 2b 34 2b 74 3b 74 6b f4 00 39 01 00 00 00 00 03 f0 5a 5a 39 01 00 00 00 00 02 60 21 39 01 00 00 00 00 02 f7 0b 39 01 00 00 00 00 03 f0 a5 a5 39 01 00 00 00 00 03 f0 5a 5a 39 01 00 00 00 00 04 b0 00 0d b2 39 01 00 00 00 00 02 b2 20 39 01 00 00 00 00 04 b0 00 0c b2 39 01 00 00 00 00 02 b2 30 39 01 00 00 00 00 03 f0 a5 a5 39 01 00 00 00 00 02 53 28 39 01 00 00 00 00 02 f7 0b 39 01 00 00 00 00 03 f0 5a 5a 39 01 00 00 00 00 04 cd 29 00 08 39 01 00 00 00 00 03 f0 a5 a5 39 01 00 00 00 00 03 f0 5a 5a 39 01 00 00 00 00 03 fc 5a 5a 39 01 00 00 00 00 02 fe b0 39 01 00 00 00 00 02 fe 30 39 01 00 00 00 00 02 f7 0b 39 01 00 00 00 00 03 fc a5 a5 39 01 00 00 64 00 03 f0 a5 a5 05 01 00 00 1e 00 02 29 00];
						qcom,mdss-dsi-on-command-state = "dsi_lp_mode";
						qcom,mdss-dsi-panel-framerate = <0x5a>;
						qcom,mdss-dsi-panel-height = <0x960>;
						qcom,mdss-dsi-panel-phy-timings = [00 24 09 0a 1a 25 09 0a 09 02 04 00 1e 0f];
						qcom,mdss-dsi-panel-width = <0x438>;
						qcom,mdss-dsi-pre-off-command = <0x5010000 0xa000128 0x5010000 0x96000110>;
						qcom,mdss-dsi-pre-off-command-state = "dsi_hs_mode";
						qcom,mdss-dsi-v-back-porch = <0xa>;
						qcom,mdss-dsi-v-front-porch = <0x14>;
						qcom,mdss-dsi-v-pulse-width = <0x2>;
					};
				};
			};
		};
	};

	fragment@4 {
		target = <0xffffffff>;

		__overlay__ {

			qcom,mdss_dsi_nt36672e_fhd_plus_90hz_video {
				phandle = <0x4>;
				pwms = <0xffffffff 0x0 0x0>;
				qcom,adjust-timer-wakeup-ms = <0x1>;
				qcom,bl-pmic-pwm-period-usecs = <0x64>;
				qcom,dsi-ctrl-num = <0x0>;
				qcom,dsi-phy-num = <0x0>;
				qcom,dsi-select-clocks = "mux_byte_clk0", "mux_pixel_clk0";
				qcom,mdss-dsi-bl-max-level = <0xfff>;
				qcom,mdss-dsi-bl-min-level = <0x1>;
				qcom,mdss-dsi-bl-pmic-control-type = "bl_ctrl_pwm";
				qcom,mdss-dsi-bllp-eof-power-mode;
				qcom,mdss-dsi-bllp-power-mode;
				qcom,mdss-dsi-border-color = <0x0>;
				qcom,mdss-dsi-bpp = <0x18>;
				qcom,mdss-dsi-dma-trigger = "trigger_sw";
				qcom,mdss-dsi-lane-0-state;
				qcom,mdss-dsi-lane-1-state;
				qcom,mdss-dsi-lane-2-state;
				qcom,mdss-dsi-lane-3-state;
				qcom,mdss-dsi-mdp-trigger = "none";
				qcom,mdss-dsi-panel-blackness-level = <0x1361>;
				qcom,mdss-dsi-panel-hdr-color-primaries = <0x9858 0x3e80 0x83d6 0x9b78 0x33c2 0x8692 0x1d4c 0xbb8>;
				qcom,mdss-dsi-panel-hdr-enabled;
				qcom,mdss-dsi-panel-name = "nt36672e 90Hz fhd plus video mode panel with DSC";
				qcom,mdss-dsi-panel-peak-brightness = <0x626b50>;
				qcom,mdss-dsi-panel-status-check-mode = "reg_read";
				qcom,mdss-dsi-panel-status-command = <0x6010001 0x10a>;
				qcom,mdss-dsi-panel-status-command-state = "dsi_lp_mode";
				qcom,mdss-dsi-panel-status-read-length = <0x1>;
				qcom,mdss-dsi-panel-status-value = <0x9c>;
				qcom,mdss-dsi-panel-type = "dsi_video_mode";
				qcom,mdss-dsi-reset-sequence = <0x1 0xa 0x0 0xa 0x1 0xa>;
				qcom,mdss-dsi-stream = <0x0>;
				qcom,mdss-dsi-traffic-mode = "burst_mode";
				qcom,mdss-dsi-tx-eot-append;
				qcom,mdss-dsi-virtual-channel-id = <0x0>;
				qcom,panel-supply-entries = <0x1>;
				qcom,platform-bklight-en-gpio = <0x2 0x1 0x0>;
				qcom,platform-en-gpio = <0x2 0x5 0x0>;
				qcom,platform-reset-gpio = <0xffffffff 0x52 0x0>;

				qcom,mdss-dsi-display-timings {

					timing@0 {
						qcom,compression-mode = "dsc";
						qcom,default-topology-index = <0x0>;
						qcom,display-topology = <0x1 0x1 0x1>;
						qcom,mdss-dsc-bit-per-component = <0x8>;
						qcom,mdss-dsc-bit-per-pixel = <0x8>;
						qcom,mdss-dsc-block-prediction-enable;
						qcom,mdss-dsc-slice-height = <0x8>;
						qcom,mdss-dsc-slice-per-pkt = <0x1>;
						qcom,mdss-dsc-slice-width = <0x21c>;
						qcom,mdss-dsi-h-back-porch = <0x44>;
						qcom,mdss-dsi-h-front-porch = <0x4c>;
						qcom,mdss-dsi-h-pulse-width = <0xa>;
						qcom,mdss-dsi-h-sync-skew = <0x0>;
						qcom,mdss-dsi-off-command = <0x5010000 0x10000128 0x5010000 0x32000110>;
						qcom,mdss-dsi-off-command-state = "dsi_lp_mode";
						qcom,mdss-dsi-on-command = [39 01 00 00 00 00 02 ff 10 39 01 00 00 00 00 02 fb 01 39 01 00 00 00 00 02 b0 00 39 01 00 00 00 00 02 c0 03 39 01 00 00 00 00 11 c1 89 28 00 08 00 aa 02 0e 00 2b 00 07 0d b7 0c b7 39 01 00 00 00 00 03 c2 1b a0 39 01 00 00 00 00 02 ff 20 39 01 00 00 00 00 02 fb 01 39 01 00 00 00 00 02 01 66 39 01 00 00 00 00 02 06 40 39 01 00 00 00 00 02 07 38 39 01 00 00 00 00 02 18 66 39 01 00 00 00 00 02 1b 01 39 01 00 00 00 00 02 5c 90 39 01 00 00 00 00 02 5e aa 39 01 00 00 00 00 02 69 91 39 01 00 00 00 00 02 89 0d 39 01 00 00 00 00 02 8a 0d 39 01 00 00 00 00 02 8d 0d 39 01 00 00 00 00 02 8e 0d 39 01 00 00 00 00 02 8f 0d 39 01 00 00 00 00 02 91 0d 39 01 00 00 00 00 02 95 d1 39 01 00 00 00 00 02 96 d1 39 01 00 00 00 00 02 f2 65 39 01 00 00 00 00 02 f3 64 39 01 00 00 00 00 02 f4 65 39 01 00 00 00 00 02 f5 64 39 01 00 00 00 00 02 f6 65 39 01 00 00 00 00 02 f7 64 39 01 00 00 00 00 02 f8 65 39 01 00 00 00 00 02 f9 64 39 01 00 00 00 00 02 ff 24 39 01 00 00 00 00 02 fb 01 39 01 00 00 00 00 02 01 0f 39 01 00 00 00 00 02 03 0c 39 01 00 00 00 00 02 05 1d 39 01 00 00 00 00 02 08 2f 39 01 00 00 00 00 02 09 2e 39 01 00 00 00 00 02 0a 2d 39 01 00 00 00 00 02 0b 2c 39 01 00 00 00 00 02 11 17 39 01 00 00 00 00 02 12 13 39 01 00 00 00 00 02 13 15 39 01 00 00 00 00 02 15 14 39 01 00 00 00 00 02 16 16 39 01 00 00 00 00 02 17 18 39 01 00 00 00 00 02 1b 01 39 01 00 00 00 00 02 1d 1d 39 01 00 00 00 00 02 20 2f 39 01 00 00 00 00 02 21 2e 39 01 00 00 00 00 02 22 2d 39 01 00 00 00 00 02 23 2c 39 01 00 00 00 00 02 29 17 39 01 00 00 00 00 02 2a 13 39 01 00 00 00 00 02 2b 15 39 01 00 00 00 00 02 2f 14 39 01 00 00 00 00 02 30 16 39 01 00 00 00 00 02 31 18 39 01 00 00 00 00 02 32 04 39 01 00 00 00 00 02 34 10 39 01 00 00 00 00 02 35 1f 39 01 00 00 00 00 02 36 1f 39 01 00 00 00 00 02 4d 19 39 01 00 00 00 00 02 4e 45 39 01 00 00 00 00 02 4f 45 39 01 00 00 00 00 02 53 45 39 01 00 00 00 00 02 71 30 39 01 00 00 00 00 02 79 11 39 01 00 00 00 00 02 7a 82 39 01 00 00 00 00 02 7b 94 39 01 00 00 00 00 02 7d 04 39 01 00 00 00 00 02 80 04 39 01 00 00 00 00 02 81 04 39 01 00 00 00 00 02 82 13 39 01 00 00 00 00 02 84 31 39 01 00 00 00 00 02 85 00 39 01 00 00 00 00 02 86 00 39 01 00 00 00 00 02 87 00 39 01 00 00 00 00 02 90 13 39 01 00 00 00 00 02 92 31 39 01 00 00 00 00 02 93 00 39 01 00 00 00 00 02 94 00 39 01 00 00 00 00 02 95 00 39 01 00 00 00 00 02 9c f4 39 01 00 00 00 00 02 9d 01 39 01 00 00 00 00 02 a0 14 39 01 00 00 00 00 02 a2 14 39 01 00 00 00 00 02 a3 02 39 01 00 00 00 00 02 a4 04 39 01 00 00 00 00 02 a5 04 39 01 00 00 00 00 02 c4 40 39 01 00 00 00 00 02 c6 c0 39 01 00 00 00 00 02 c9 00 39 01 00 00 00 00 02 d9 80 39 01 00 00 00 00 02 e9 02 39 01 00 00 00 00 02 ff 25 39 01 00 00 00 00 02 fb 01 39 01 00 00 00 00 02 0f 1b 39 01 00 00 00 00 02 19 e4 39 01 00 00 00 00 02 21 40 39 01 00 00 00 00 02 66 d8 39 01 00 00 00 00 02 68 50 39 01 00 00 00 00 02 69 10 39 01 00 00 00 00 02 6b 00 39 01 00 00 00 00 02 6d 0d 39 01 00 00 00 00 02 6e 48 39 01 00 00 00 00 02 72 41 39 01 00 00 00 00 02 73 4a 39 01 00 00 00 00 02 74 d0 39 01 00 00 00 00 02 77 62 39 01 00 00 00 00 02 79 7f 39 01 00 00 00 00 02 7d 40 39 01 00 00 00 00 02 7f 00 39 01 00 00 00 00 02 80 04 39 01 00 00 00 00 02 84 0d 39 01 00 00 00 00 02 cf 80 39 01 00 00 00 00 02 d6 80 39 01 00 00 00 00 02 d7 80 39 01 00 00 00 00 02 ef 20 39 01 00 00 00 00 02 f0 84 39 01 00 00 00 00 02 ff 26 39 01 00 00 00 00 02 fb 01 39 01 00 00 00 00 02 15 04 39 01 00 00 00 00 02 81 14 39 01 00 00 00 00 02 83 02 39 01 00 00 00 00 02 84 03 39 01 00 00 00 00 02 85 01 39 01 00 00 00 00 02 86 03 39 01 00 00 00 00 02 87 01 39 01 00 00 00 00 02 88 06 39 01 00 00 00 00 02 8a 1a 39 01 00 00 00 00 02 8b 11 39 01 00 00 00 00 02 8c 24 39 01 00 00 00 00 02 8e 42 39 01 00 00 00 00 02 8f 11 39 01 00 00 00 00 02 90 11 39 01 00 00 00 00 02 91 11 39 01 00 00 00 00 02 9a 81 39 01 00 00 00 00 02 9b 03 39 01 00 00 00 00 02 9c 00 39 01 00 00 00 00 02 9d 00 39 01 00 00 00 00 02 9e 00 39 01 00 00 00 00 02 ff 27 39 01 00 00 00 00 02 fb 01 39 01 00 00 00 00 02 01 68 39 01 00 00 00 00 02 20 81 39 01 00 00 00 00 02 21 ea 39 01 00 00 00 00 02 25 82 39 01 00 00 00 00 02 26 1f 39 01 00 00 00 00 02 6e 00 39 01 00 00 00 00 02 6f 00 39 01 00 00 00 00 02 70 00 39 01 00 00 00 00 02 71 00 39 01 00 00 00 00 02 72 00 39 01 00 00 00 00 02 75 00 39 01 00 00 00 00 02 76 00 39 01 00 00 00 00 02 77 00 39 01 00 00 00 00 02 7d 09 39 01 00 00 00 00 02 7e 67 39 01 00 00 00 00 02 80 23 39 01 00 00 00 00 02 82 09 39 01 00 00 00 00 02 83 67 39 01 00 00 00 00 02 88 01 39 01 00 00 00 00 02 89 10 39 01 00 00 00 00 02 a5 10 39 01 00 00 00 00 02 a6 23 39 01 00 00 00 00 02 a7 01 39 01 00 00 00 00 02 b6 40 39 01 00 00 00 00 02 e3 02 39 01 00 00 00 00 02 e4 e0 39 01 00 00 00 00 02 e5 01 39 01 00 00 00 00 02 e6 70 39 01 00 00 00 00 02 e9 03 39 01 00 00 00 00 02 ea 2f 39 01 00 00 00 00 02 eb 01 39 01 00 00 00 00 02 ec 98 39 01 00 00 00 00 02 ff 2a 39 01 00 00 00 00 02 fb 01 39 01 00 00 00 00 02 00 91 39 01 00 00 00 00 02 03 20 39 01 00 00 00 00 02 07 5a 39 01 00 00 00 00 02 0a 70 39 01 00 00 00 00 02 0d 40 39 01 00 00 00 00 02 0e 02 39 01 00 00 00 00 02 11 f0 39 01 00 00 00 00 02 15 0f 39 01 00 00 00 00 02 16 65 39 01 00 00 00 00 02 19 0f 39 01 00 00 00 00 02 1a 39 39 01 00 00 00 00 02 1b 14 39 01 00 00 00 00 02 1d 36 39 01 00 00 00 00 02 1e 4f 39 01 00 00 00 00 02 1f 4f 39 01 00 00 00 00 02 20 4f 39 01 00 00 00 00 02 28 e4 39 01 00 00 00 00 02 29 17 39 01 00 00 00 00 02 2a f5 39 01 00 00 00 00 02 2d 06 39 01 00 00 00 00 02 2f 04 39 01 00 00 00 00 02 30 54 39 01 00 00 00 00 02 33 04 39 01 00 00 00 00 02 34 e6 39 01 00 00 00 00 02 35 32 39 01 00 00 00 00 02 36 02 39 01 00 00 00 00 02 37 e1 39 01 00 00 00 00 02 38 36 39 01 00 00 00 00 02 39 fe 39 01 00 00 00 00 02 3a 14 39 01 00 00 00 00 02 46 40 39 01 00 00 00 00 02 47 02 39 01 00 00 00 00 02 4a f0 39 01 00 00 00 00 02 4e 0f 39 01 00 00 00 00 02 4f 65 39 01 00 00 00 00 02 52 0f 39 01 00 00 00 00 02 53 39 39 01 00 00 00 00 02 54 14 39 01 00 00 00 00 02 56 36 39 01 00 00 00 00 02 57 7e 39 01 00 00 00 00 02 58 7e 39 01 00 00 00 00 02 59 7e 39 01 00 00 00 00 02 60 80 39 01 00 00 00 00 02 61 c9 39 01 00 00 00 00 02 62 03 39 01 00 00 00 00 02 63 fb 39 01 00 00 00 00 02 64 03 39 01 00 00 00 00 02 65 05 39 01 00 00 00 00 02 66 01 39 01 00 00 00 00 02 67 04 39 01 00 00 00 00 02 68 91 39 01 00 00 00 00 02 6a 19 39 01 00 00 00 00 02 6b cb 39 01 00 00 00 00 02 6c 20 39 01 00 00 00 00 02 6d e5 39 01 00 00 00 00 02 6e c8 39 01 00 00 00 00 02 6f 22 39 01 00 00 00 00 02 70 e3 39 01 00 00 00 00 02 71 04 39 01 00 00 00 00 02 7a 07 39 01 00 00 00 00 02 7b 40 39 01 00 00 00 00 02 7d 01 39 01 00 00 00 00 02 7f 2c 39 01 00 00 00 00 02 83 0f 39 01 00 00 00 00 02 84 65 39 01 00 00 00 00 02 87 0f 39 01 00 00 00 00 02 88 39 39 01 00 00 00 00 02 89 14 39 01 00 00 00 00 02 8b 36 39 01 00 00 00 00 02 8c 39 39 01 00 00 00 00 02 8d 39 39 01 00 00 00 00 02 8e 39 39 01 00 00 00 00 02 95 80 39 01 00 00 00 00 02 96 fd 39 01 00 00 00 00 02 97 14 39 01 00 00 00 00 02 98 b3 39 01 00 00 00 00 02 99 01 39 01 00 00 00 00 02 9a 08 39 01 00 00 00 00 02 9b 02 39 01 00 00 00 00 02 9c 4c 39 01 00 00 00 00 02 9d bc 39 01 00 00 00 00 02 9f ac 39 01 00 00 00 00 02 a0 ff 39 01 00 00 00 00 02 a2 44 39 01 00 00 00 00 02 a3 78 39 01 00 00 00 00 02 a4 f8 39 01 00 00 00 00 02 a5 4a 39 01 00 00 00 00 02 a6 72 39 01 00 00 00 00 02 a7 4c 39 01 00 00 00 00 02 ff 2c 39 01 00 00 00 00 02 fb 01 39 01 00 00 00 00 02 00 02 39 01 00 00 00 00 02 01 02 39 01 00 00 00 00 02 02 02 39 01 00 00 00 00 02 03 16 39 01 00 00 00 00 02 04 16 39 01 00 00 00 00 02 05 16 39 01 00 00 00 00 02 0d 1f 39 01 00 00 00 00 02 0e 1f 39 01 00 00 00 00 02 16 1b 39 01 00 00 00 00 02 17 4b 39 01 00 00 00 00 02 18 4b 39 01 00 00 00 00 02 19 4b 39 01 00 00 00 00 02 2a 03 39 01 00 00 00 00 02 4d 16 39 01 00 00 00 00 02 4e 02 39 01 00 00 00 00 02 4f 2f 39 01 00 00 00 00 02 53 02 39 01 00 00 00 00 02 54 02 39 01 00 00 00 00 02 55 02 39 01 00 00 00 00 02 56 0e 39 01 00 00 00 00 02 58 0e 39 01 00 00 00 00 02 59 0e 39 01 00 00 00 00 02 61 1f 39 01 00 00 00 00 02 62 1f 39 01 00 00 00 00 02 6a 14 39 01 00 00 00 00 02 6b 34 39 01 00 00 00 00 02 6c 34 39 01 00 00 00 00 02 6d 34 39 01 00 00 00 00 02 7e 03 39 01 00 00 00 00 02 9d 0e 39 01 00 00 00 00 02 9e 02 39 01 00 00 00 00 02 9f 02 39 01 00 00 00 00 02 ff 20 39 01 00 00 00 00 02 fb 01 39 01 00 00 00 00 11 b0 00 00 00 15 00 3f 00 5f 00 7e 00 97 00 af 00 c3 39 01 00 00 00 00 11 b1 00 d7 01 0a 01 32 01 6f 01 9e 01 e5 02 1d 02 1e 39 01 00 00 00 00 11 b2 02 56 02 94 02 bc 02 f1 03 13 03 41 03 4f 03 5f 39 01 00 00 00 00 0f b3 03 71 03 84 03 99 03 b0 03 ca 03 d7 00 00 39 01 00 00 00 00 11 b4 00 00 00 17 00 46 00 69 00 8c 00 a5 00 be 00 d1 39 01 00 00 00 00 11 b5 00 e4 01 18 01 40 01 7c 01 aa 01 f0 02 27 02 28 39 01 00 00 00 00 11 b6 02 5e 02 9b 02 c3 02 f6 03 18 03 45 03 54 03 63 39 01 00 00 00 00 0f b7 03 75 03 87 03 9c 03 b2 03 ca 03 d7 00 00 39 01 00 00 00 00 11 b8 00 00 00 18 00 49 00 6b 00 8e 00 a8 00 c1 00 d3 39 01 00 00 00 00 11 b9 00 e5 01 18 01 3f 01 7b 01 a8 01 ec 02 24 02 26 39 01 00 00 00 00 11 ba 02 5a 02 97 02 c0 02 f4 03 15 03 43 03 51 03 61 39 01 00 00 00 00 0f bb 03 72 03 85 03 9a 03 b1 03 ca 03 d7 00 00 39 01 00 00 00 00 02 c6 00 39 01 00 00 00 00 02 c7 00 39 01 00 00 00 00 02 c8 00 39 01 00 00 00 00 02 c9 00 39 01 00 00 00 00 02 ca 00 39 01 00 00 00 00 02 cb 00 39 01 00 00 00 00 02 cc 00 39 01 00 00 00 00 02 cd 00 39 01 00 00 00 00 02 ce 00 39 01 00 00 00 00 02 cf 00 39 01 00 00 00 00 02 d0 00 39 01 00 00 00 00 02 d1 00 39 01 00 00 00 00 02 d2 00 39 01 00 00 00 00 02 d3 00 39 01 00 00 00 00 02 d4 00 39 01 00 00 00 00 02 d5 00 39 01 00 00 00 00 02 d6 00 39 01 00 00 00 00 02 d7 00 39 01 00 00 00 00 02 d8 00 39 01 00 00 00 00 02 d9 00 39 01 00 00 00 00 02 da 00 39 01 00 00 00 00 02 db 00 39 01 00 00 00 00 02 dc 00 39 01 00 00 00 00 02 dd 00 39 01 00 00 00 00 02 de 00 39 01 00 00 00 00 02 df 00 39 01 00 00 00 00 02 e0 00 39 01 00 00 00 00 02 e1 00 39 01 00 00 00 00 02 e2 00 39 01 00 00 00 00 02 e3 00 39 01 00 00 00 00 02 e4 00 39 01 00 00 00 00 02 e5 00 39 01 00 00 00 00 02 e6 00 39 01 00 00 00 00 02 e7 00 39 01 00 00 00 00 02 e8 00 39 01 00 00 00 00 02 e9 00 39 01 00 00 00 00 02 ff 21 39 01 00 00 00 00 02 fb 01 39 01 00 00 00 00 11 b0 00 00 00 15 00 3f 00 5f 00 7e 00 97 00 af 00 c3 39 01 00 00 00 00 11 b1 00 d7 01 0a 01 32 01 6f 01 9e 01 e5 02 1d 02 1e 39 01 00 00 00 00 11 b2 02 56 02 94 02 bc 02 f1 03 13 03 41 03 4f 03 5f 39 01 00 00 00 00 0f b3 03 71 03 84 03 99 03 b0 03 ca 03 d7 00 00 39 01 00 00 00 00 11 b4 00 00 00 17 00 46 00 69 00 8c 00 a5 00 be 00 d1 39 01 00 00 00 00 11 b5 00 e4 01 18 01 40 01 7c 01 aa 01 f0 02 27 02 28 39 01 00 00 00 00 11 b6 02 5e 02 9b 02 c3 02 f6 03 18 03 45 03 54 03 63 39 01 00 00 00 00 0f b7 03 75 03 87 03 9c 03 b2 03 ca 03 d7 00 00 39 01 00 00 00 00 11 b8 00 00 00 18 00 49 00 6b 00 8e 00 a8 00 c1 00 d3 39 01 00 00 00 00 11 b9 00 e5 01 18 01 3f 01 7b 01 a8 01 ec 02 24 02 26 39 01 00 00 00 00 11 ba 02 5a 02 97 02 c0 02 f4 03 15 03 43 03 51 03 61 39 01 00 00 00 00 0f bb 03 72 03 85 03 9a 03 b1 03 ca 03 d7 00 00 39 01 00 00 00 00 02 ff e0 39 01 00 00 00 00 02 fb 01 39 01 00 00 00 00 02 35 82 39 01 00 00 00 00 02 85 32 39 01 00 00 00 00 02 ff f0 39 01 00 00 00 00 02 fb 01 39 01 00 00 00 00 02 1c 01 39 01 00 00 00 00 02 33 01 39 01 00 00 00 00 02 5a 00 39 01 00 00 00 00 02 ff d0 39 01 00 00 00 00 02 fb 01 39 01 00 00 00 00 02 53 22 39 01 00 00 00 00 02 54 02 39 01 00 00 00 00 02 ff c0 39 01 00 00 00 00 02 fb 01 39 01 00 00 00 00 02 9c 11 39 01 00 00 00 00 02 9d 11 39 01 00 00 00 00 02 ff 2b 39 01 00 00 00 00 02 fb 01 39 01 00 00 00 00 02 b7 0a 39 01 00 00 00 00 02 b8 1c 39 01 00 00 00 00 02 c0 01 39 01 00 00 00 00 02 ff 10 39 01 00 00 00 00 02 35 01 39 01 00 00 00 00 02 51 ff 39 01 00 00 00 00 02 53 0c 39 01 00 00 00 00 02 55 00 05 01 00 00 78 00 01 11 05 01 00 00 28 00 01 29];
						qcom,mdss-dsi-on-command-state = "dsi_lp_mode";
						qcom,mdss-dsi-panel-framerate = <0x5a>;
						qcom,mdss-dsi-panel-height = <0x968>;
						qcom,mdss-dsi-panel-phy-timings = [00 18 06 06 21 20 06 06 07 02 04 00 16 16];
						qcom,mdss-dsi-panel-width = <0x438>;
						qcom,mdss-dsi-v-back-porch = <0xa>;
						qcom,mdss-dsi-v-front-porch = <0x2e>;
						qcom,mdss-dsi-v-pulse-width = <0xa>;
					};
				};
			};
		};
	};

	fragment@5 {
		target = <0xffffffff>;

		__overlay__ {

			qcom,mdss_dsi_nt36672e_fhd_plus_120hz_video {
				phandle = <0x5>;
				qcom,adjust-timer-wakeup-ms = <0x1>;
				qcom,dsi-ctrl-num = <0x0>;
				qcom,dsi-phy-num = <0x0>;
				qcom,dsi-select-clocks = "mux_byte_clk0", "mux_pixel_clk0";
				qcom,esd-check-enabled;
				qcom,mdss-dsi-bllp-eof-power-mode;
				qcom,mdss-dsi-bllp-power-mode;
				qcom,mdss-dsi-border-color = <0x0>;
				qcom,mdss-dsi-bpp = <0x18>;
				qcom,mdss-dsi-dma-trigger = "trigger_sw";
				qcom,mdss-dsi-lane-0-state;
				qcom,mdss-dsi-lane-1-state;
				qcom,mdss-dsi-lane-2-state;
				qcom,mdss-dsi-lane-3-state;
				qcom,mdss-dsi-mdp-trigger = "none";
				qcom,mdss-dsi-panel-blackness-level = <0x1361>;
				qcom,mdss-dsi-panel-hdr-color-primaries = <0x3a98 0x3e80 0x83d6 0x3db8 0x33c2 0x8692 0x1d4c 0xbb8>;
				qcom,mdss-dsi-panel-hdr-enabled;
				qcom,mdss-dsi-panel-name = "nt36672e fhd plus 120Hz Video panel";
				qcom,mdss-dsi-panel-peak-brightness = <0x626b50>;
				qcom,mdss-dsi-panel-status-check-mode = "reg_read";
				qcom,mdss-dsi-panel-status-command = <0x6010001 0x10a>;
				qcom,mdss-dsi-panel-status-command-state = "dsi_lp_mode";
				qcom,mdss-dsi-panel-status-read-length = <0x1>;
				qcom,mdss-dsi-panel-status-value = <0x9c>;
				qcom,mdss-dsi-panel-type = "dsi_video_mode";
				qcom,mdss-dsi-reset-sequence = <0x1 0xa 0x0 0xa 0x1 0xa>;
				qcom,mdss-dsi-stream = <0x0>;
				qcom,mdss-dsi-traffic-mode = "burst_mode";
				qcom,mdss-dsi-tx-eot-append;
				qcom,mdss-dsi-virtual-channel-id = <0x0>;

				qcom,mdss-dsi-display-timings {

					timing@0 {
						qcom,compression-mode = "dsc";
						qcom,default-topology-index = <0x0>;
						qcom,display-topology = <0x1 0x1 0x1>;
						qcom,mdss-dsc-bit-per-component = <0x8>;
						qcom,mdss-dsc-bit-per-pixel = <0x8>;
						qcom,mdss-dsc-block-prediction-enable;
						qcom,mdss-dsc-slice-height = <0x8>;
						qcom,mdss-dsc-slice-per-pkt = <0x1>;
						qcom,mdss-dsc-slice-width = <0x21c>;
						qcom,mdss-dsi-h-back-porch = <0x3c>;
						qcom,mdss-dsi-h-front-porch = <0x4c>;
						qcom,mdss-dsi-h-pulse-width = <0xa>;
						qcom,mdss-dsi-h-sync-skew = <0x0>;
						qcom,mdss-dsi-off-command = <0x5010000 0x10000128 0x5010000 0x32000110>;
						qcom,mdss-dsi-off-command-state = "dsi_lp_mode";
						qcom,mdss-dsi-on-command = [15 01 00 00 00 00 02 fb 01 15 01 00 00 00 00 02 b0 00 15 01 00 00 00 00 02 c0 03 39 01 00 00 00 00 11 c1 89 28 00 08 00 aa 02 0e 00 2b 00 07 0d b7 0c b7 39 01 00 00 00 00 03 c2 1b a0 15 01 00 00 00 00 02 ff 20 15 01 00 00 00 00 02 fb 01 15 01 00 00 00 00 02 01 66 15 01 00 00 00 00 02 06 40 15 01 00 00 00 00 02 07 38 15 01 00 00 00 00 02 2f 83 15 01 00 00 00 00 02 69 91 15 01 00 00 00 00 02 95 d1 15 01 00 00 00 00 02 96 d1 15 01 00 00 00 00 02 f2 64 15 01 00 00 00 00 02 f4 64 15 01 00 00 00 00 02 f6 64 15 01 00 00 00 00 02 f8 64 15 01 00 00 00 00 02 89 1c 15 01 00 00 00 00 02 8a 1c 15 01 00 00 00 00 02 8b 1c 15 01 00 00 00 00 02 8c 1c 15 01 00 00 00 00 02 ff 24 15 01 00 00 00 00 02 fb 01 15 01 00 00 00 00 02 01 0f 15 01 00 00 00 00 02 03 0c 15 01 00 00 00 00 02 05 1d 15 01 00 00 00 00 02 08 2f 15 01 00 00 00 00 02 09 2e 15 01 00 00 00 00 02 0a 2d 15 01 00 00 00 00 02 0b 2c 15 01 00 00 00 00 02 11 17 15 01 00 00 00 00 02 12 13 15 01 00 00 00 00 02 13 15 15 01 00 00 00 00 02 15 14 15 01 00 00 00 00 02 16 16 15 01 00 00 00 00 02 17 18 15 01 00 00 00 00 02 1b 01 15 01 00 00 00 00 02 1d 1d 15 01 00 00 00 00 02 20 2f 15 01 00 00 00 00 02 21 2e 15 01 00 00 00 00 02 22 2d 15 01 00 00 00 00 02 23 2c 15 01 00 00 00 00 02 29 17 15 01 00 00 00 00 02 2a 13 15 01 00 00 00 00 02 2b 15 15 01 00 00 00 00 02 2f 14 15 01 00 00 00 00 02 30 16 15 01 00 00 00 00 02 31 18 15 01 00 00 00 00 02 32 04 15 01 00 00 00 00 02 34 10 15 01 00 00 00 00 02 35 1f 15 01 00 00 00 00 02 36 1f 15 01 00 00 00 00 02 4d 14 15 01 00 00 00 00 02 4e 36 15 01 00 00 00 00 02 4f 36 15 01 00 00 00 00 02 53 36 15 01 00 00 00 00 02 71 30 15 01 00 00 00 00 02 79 11 15 01 00 00 00 00 02 7a 82 15 01 00 00 00 00 02 7b 8f 15 01 00 00 00 00 02 7d 04 15 01 00 00 00 00 02 80 04 15 01 00 00 00 00 02 81 04 15 01 00 00 00 00 02 82 13 15 01 00 00 00 00 02 84 31 15 01 00 00 00 00 02 85 00 15 01 00 00 00 00 02 86 00 15 01 00 00 00 00 02 87 00 15 01 00 00 00 00 02 90 13 15 01 00 00 00 00 02 92 31 15 01 00 00 00 00 02 93 00 15 01 00 00 00 00 02 94 00 15 01 00 00 00 00 02 95 00 15 01 00 00 00 00 02 9c f4 15 01 00 00 00 00 02 9d 01 15 01 00 00 00 00 02 a0 0f 15 01 00 00 00 00 02 a2 0f 15 01 00 00 00 00 02 a3 02 15 01 00 00 00 00 02 a4 04 15 01 00 00 00 00 02 a5 04 15 01 00 00 00 00 02 c4 40 15 01 00 00 00 00 02 c6 c0 15 01 00 00 00 00 02 c9 00 15 01 00 00 00 00 02 d9 80 15 01 00 00 00 00 02 e9 02 15 01 00 00 00 00 02 ff 25 15 01 00 00 00 00 02 fb 01 15 01 00 00 00 00 02 19 e4 15 01 00 00 00 00 02 21 40 15 01 00 00 00 00 02 66 d8 15 01 00 00 00 00 02 68 50 15 01 00 00 00 00 02 69 10 15 01 00 00 00 00 02 6b 00 15 01 00 00 00 00 02 6d 0d 15 01 00 00 00 00 02 6e 48 15 01 00 00 00 00 02 72 41 15 01 00 00 00 00 02 73 4a 15 01 00 00 00 00 02 74 d0 15 01 00 00 00 00 02 77 62 15 01 00 00 00 00 02 79 81 15 01 00 00 00 00 02 7d 03 15 01 00 00 00 00 02 7e 15 15 01 00 00 00 00 02 7f 00 15 01 00 00 00 00 02 84 4d 15 01 00 00 00 00 02 cf 80 15 01 00 00 00 00 02 d6 80 15 01 00 00 00 00 02 d7 80 15 01 00 00 00 00 02 ef 20 15 01 00 00 00 00 02 f0 84 15 01 00 00 00 00 02 ff 26 15 01 00 00 00 00 02 fb 01 15 01 00 00 00 00 02 80 05 15 01 00 00 00 00 02 81 0f 15 01 00 00 00 00 02 83 01 15 01 00 00 00 00 02 84 03 15 01 00 00 00 00 02 85 01 15 01 00 00 00 00 02 86 03 15 01 00 00 00 00 02 87 01 15 01 00 00 00 00 02 88 05 15 01 00 00 00 00 02 8a 1a 15 01 00 00 00 00 02 8b 11 15 01 00 00 00 00 02 8c 24 15 01 00 00 00 00 02 8e 42 15 01 00 00 00 00 02 8f 11 15 01 00 00 00 00 02 90 11 15 01 00 00 00 00 02 91 11 15 01 00 00 00 00 02 9a 80 15 01 00 00 00 00 02 9b 04 15 01 00 00 00 00 02 9c 00 15 01 00 00 00 00 02 9d 00 15 01 00 00 00 00 02 9e 00 15 01 00 00 00 00 02 ff 27 15 01 00 00 00 00 02 fb 01 15 01 00 00 00 00 02 01 68 15 01 00 00 00 00 02 20 81 15 01 00 00 00 00 02 21 6a 15 01 00 00 00 00 02 25 81 15 01 00 00 00 00 02 26 94 15 01 00 00 00 00 02 6e 00 15 01 00 00 00 00 02 6f 00 15 01 00 00 00 00 02 70 00 15 01 00 00 00 00 02 71 00 15 01 00 00 00 00 02 72 00 15 01 00 00 00 00 02 75 00 15 01 00 00 00 00 02 76 00 15 01 00 00 00 00 02 77 00 15 01 00 00 00 00 02 7d 09 15 01 00 00 00 00 02 7e 67 15 01 00 00 00 00 02 80 23 15 01 00 00 00 00 02 82 09 15 01 00 00 00 00 02 83 67 15 01 00 00 00 00 02 88 01 15 01 00 00 00 00 02 89 10 15 01 00 00 00 00 02 a5 10 15 01 00 00 00 00 02 a6 23 15 01 00 00 00 00 02 a7 01 15 01 00 00 00 00 02 b6 40 15 01 00 00 00 00 02 ff 2a 15 01 00 00 00 00 02 fb 01 15 01 00 00 00 00 02 00 91 15 01 00 00 00 00 02 03 20 15 01 00 00 00 00 02 07 50 15 01 00 00 00 00 02 0a 70 15 01 00 00 00 00 02 0c 04 15 01 00 00 00 00 02 0d 40 15 01 00 00 00 00 02 0f 01 15 01 00 00 00 00 02 11 e0 15 01 00 00 00 00 02 15 0f 15 01 00 00 00 00 02 16 a4 15 01 00 00 00 00 02 19 0f 15 01 00 00 00 00 02 1a 78 15 01 00 00 00 00 02 1b 23 15 01 00 00 00 00 02 1d 36 15 01 00 00 00 00 02 1e 3e 15 01 00 00 00 00 02 1f 3e 15 01 00 00 00 00 02 20 3e 15 01 00 00 00 00 02 28 fd 15 01 00 00 00 00 02 29 12 15 01 00 00 00 00 02 2a e1 15 01 00 00 00 00 02 2d 0a 15 01 00 00 00 00 02 30 49 15 01 00 00 00 00 02 33 96 15 01 00 00 00 00 02 34 ff 15 01 00 00 00 00 02 35 40 15 01 00 00 00 00 02 36 de 15 01 00 00 00 00 02 37 f9 15 01 00 00 00 00 02 38 45 15 01 00 00 00 00 02 39 d9 15 01 00 00 00 00 02 3a 49 15 01 00 00 00 00 02 4a f0 15 01 00 00 00 00 02 ff 20 15 01 00 00 00 00 02 fb 01 39 01 00 00 00 00 11 b0 00 00 00 17 00 46 00 63 00 81 00 96 00 ab 00 bd 39 01 00 00 00 00 11 b1 00 cf 01 03 01 2f 01 6e 01 9d 01 e7 02 22 02 24 39 01 00 00 00 00 11 b2 02 5d 02 9b 02 c4 02 f9 03 1b 03 48 03 56 03 65 39 01 00 00 00 00 0f b3 03 75 03 87 03 9b 03 b1 03 ca 03 d7 00 00 39 01 00 00 00 00 11 b4 00 00 00 19 00 4b 00 69 00 87 00 9c 00 b2 00 c3 39 01 00 00 00 00 11 b5 00 d5 01 0b 01 35 01 73 01 a3 01 ec 02 27 02 29 39 01 00 00 00 00 11 b6 02 60 02 9f 02 c7 02 fb 03 1d 03 4c 03 5a 03 69 39 01 00 00 00 00 0f b7 03 7a 03 8c 03 a0 03 b5 03 cb 03 d7 00 00 39 01 00 00 00 00 11 b8 00 00 00 19 00 4d 00 6a 00 87 00 9c 00 b1 00 c2 39 01 00 00 00 00 11 b9 00 d3 01 08 01 32 01 70 01 9f 01 e8 02 23 02 25 39 01 00 00 00 00 11 ba 02 5c 02 9b 02 c3 02 f8 03 1a 03 4c 03 5b 03 6b 39 01 00 00 00 00 0f bb 03 7d 03 92 03 a7 03 bb 03 ce 03 d7 00 00 15 01 00 00 00 00 02 ff 21 15 01 00 00 00 00 02 fb 01 39 01 00 00 00 00 11 b0 00 00 00 17 00 46 00 63 00 81 00 96 00 ab 00 bd 39 01 00 00 00 00 11 b1 00 cf 01 03 01 2f 01 6e 01 9d 01 e7 02 22 02 24 39 01 00 00 00 00 11 b2 02 5d 02 9b 02 c4 02 f9 03 1b 03 48 03 56 03 65 39 01 00 00 00 00 0f b3 03 75 03 87 03 9b 03 b1 03 ca 03 d7 00 00 39 01 00 00 00 00 11 b4 00 00 00 19 00 4b 00 69 00 87 00 9c 00 b2 00 c3 39 01 00 00 00 00 11 b5 00 d5 01 0b 01 35 01 73 01 a3 01 ec 02 27 02 29 39 01 00 00 00 00 11 b6 02 60 02 9f 02 c7 02 fb 03 1d 03 4c 03 5a 03 69 39 01 00 00 00 00 0f b7 03 7a 03 8c 03 a0 03 b5 03 cb 03 d7 00 00 39 01 00 00 00 00 11 b8 00 00 00 19 00 4d 00 6a 00 87 00 9c 00 b1 00 c2 39 01 00 00 00 00 11 b9 00 d3 01 08 01 32 01 70 01 9f 01 e8 02 23 02 25 39 01 00 00 00 00 11 ba 02 5c 02 9b 02 c3 02 f8 03 1a 03 4c 03 5b 03 6b 39 01 00 00 00 00 0f bb 03 7d 03 92 03 a7 03 bb 03 ce 03 d7 00 00 15 01 00 00 00 00 02 ff 10 15 01 00 00 00 00 02 ff f0 15 01 00 00 00 00 02 fb 01 15 01 00 00 00 00 02 5a 00 15 01 00 00 00 00 02 ff 10 15 01 00 00 00 00 02 ff 10 15 01 00 00 00 00 02 fb 01 15 01 00 00 00 00 02 51 ff 15 01 00 00 00 00 02 53 2c 15 01 00 00 00 00 02 55 01 05 01 00 00 c8 00 01 11 05 01 00 00 96 00 01 29];
						qcom,mdss-dsi-on-command-state = "dsi_lp_mode";
						qcom,mdss-dsi-panel-framerate = <0x78>;
						qcom,mdss-dsi-panel-height = <0x968>;
						qcom,mdss-dsi-panel-phy-timings = [00 1e 08 08 24 22 08 08 08 02 04 00 1b 18];
						qcom,mdss-dsi-panel-width = <0x438>;
						qcom,mdss-dsi-v-back-porch = <0xa>;
						qcom,mdss-dsi-v-front-porch = <0x2e>;
						qcom,mdss-dsi-v-pulse-width = <0xa>;
					};
				};
			};
		};
	};

	fragment@6 {
		target = <0xffffffff>;

		__overlay__ {

			qcom,mdss_dsi_sim_video {
				phandle = <0x18>;
				qcom,dsi-ctrl-num = <0x0>;
				qcom,dsi-phy-num = <0x0>;
				qcom,dsi-select-clocks = "mux_byte_clk0", "mux_pixel_clk0";
				qcom,mdss-dsi-bl-pmic-control-type = "bl_ctrl_dcs";
				qcom,mdss-dsi-bllp-eof-power-mode;
				qcom,mdss-dsi-bllp-power-mode;
				qcom,mdss-dsi-border-color = <0x0>;
				qcom,mdss-dsi-bpp = <0x18>;
				qcom,mdss-dsi-dma-trigger = "trigger_sw";
				qcom,mdss-dsi-lane-0-state;
				qcom,mdss-dsi-lane-1-state;
				qcom,mdss-dsi-lane-2-state;
				qcom,mdss-dsi-lane-3-state;
				qcom,mdss-dsi-mdp-trigger = "none";
				qcom,mdss-dsi-panel-blackness-level = <0xc9e>;
				qcom,mdss-dsi-panel-hdr-color-primaries = <0x38a4 0x3c8c 0x7d00 0x4268 0x3c8c 0x7530 0x1f40 0xbb8>;
				qcom,mdss-dsi-panel-hdr-enabled;
				qcom,mdss-dsi-panel-name = "Simulator video mode dsi panel";
				qcom,mdss-dsi-panel-peak-brightness = <0x401640>;
				qcom,mdss-dsi-panel-type = "dsi_video_mode";
				qcom,mdss-dsi-reset-sequence = <0x1 0x0 0x0 0x0 0x1 0x0>;
				qcom,mdss-dsi-stream = <0x0>;
				qcom,mdss-dsi-t-clk-post = <0x4>;
				qcom,mdss-dsi-t-clk-pre = <0x1b>;
				qcom,mdss-dsi-traffic-mode = "non_burst_sync_event";
				qcom,mdss-dsi-underflow-color = <0xff>;
				qcom,mdss-dsi-virtual-channel-id = <0x0>;
				qcom,panel-ack-disabled;
				qcom,panel-supply-entries = <0x1>;
				qcom,platform-reset-gpio = <0xffffffff 0x52 0x0>;

				qcom,mdss-dsi-display-timings {

					timing@0 {
						qcom,default-topology-index = <0x0>;
						qcom,display-topology = <0x1 0x0 0x1>;
						qcom,mdss-dsi-h-back-porch = <0x8>;
						qcom,mdss-dsi-h-front-porch = <0x8>;
						qcom,mdss-dsi-h-left-border = <0x0>;
						qcom,mdss-dsi-h-pulse-width = <0x8>;
						qcom,mdss-dsi-h-right-border = <0x0>;
						qcom,mdss-dsi-h-sync-pulse = <0x0>;
						qcom,mdss-dsi-h-sync-skew = <0x0>;
						qcom,mdss-dsi-off-command = [22 01 00 00 00 00 02 00 00];
						qcom,mdss-dsi-off-command-state = "dsi_lp_mode";
						qcom,mdss-dsi-on-command = [32 01 00 00 00 00 02 00 00];
						qcom,mdss-dsi-on-command-state = "dsi_lp_mode";
						qcom,mdss-dsi-panel-framerate = <0x3c>;
						qcom,mdss-dsi-panel-height = <0x1e0>;
						qcom,mdss-dsi-panel-phy-timings = [01 09 01 01 1b 1b 01 01 02 02 04 00 0a 11];
						qcom,mdss-dsi-panel-timings = <0x0 0x0 0x0>;
						qcom,mdss-dsi-panel-width = <0x280>;
						qcom,mdss-dsi-v-back-porch = <0x6>;
						qcom,mdss-dsi-v-bottom-border = <0x0>;
						qcom,mdss-dsi-v-front-porch = <0x6>;
						qcom,mdss-dsi-v-pulse-width = <0x2>;
						qcom,mdss-dsi-v-top-border = <0x0>;
					};
				};
			};
		};
	};

	fragment@7 {
		target = <0xffffffff>;

		__overlay__ {

			dsi_panel_pwr_supply_no_labibb {
				#address-cells = <0x1>;
				#size-cells = <0x0>;
				phandle = <0x1>;

				qcom,panel-supply-entry@0 {
					qcom,supply-disable-load = <0x50>;
					qcom,supply-enable-load = <0xf230>;
					qcom,supply-max-voltage = <0x1b7740>;
					qcom,supply-min-voltage = <0x1b7740>;
					qcom,supply-name = "vddio";
					qcom,supply-post-on-sleep = <0x14>;
					reg = <0x0>;
				};
			};

			qcom,dsi-display-primary {
				clock-names = "mux_byte_clk0", "mux_pixel_clk0", "src_byte_clk0", "src_pixel_clk0", "shadow_byte_clk0", "shadow_pixel_clk0";
				clocks = <0xffffffff 0x6 0xffffffff 0x9 0xffffffff 0x3 0xffffffff 0x8 0xffffffff 0xd 0xffffffff 0x11>;
				compatible = "qcom,dsi-display";
				label = "primary";
				phandle = <0x6>;
				pinctrl-0 = <0xffffffff 0xffffffff 0x3>;
				pinctrl-1 = <0xffffffff 0xffffffff>;
				pinctrl-names = "panel_active", "panel_suspend";
				qcom,dsi-ctrl = <0xffffffff>;
				qcom,dsi-default-panel = <0x4>;
				qcom,dsi-phy = <0xffffffff>;
				qcom,mdp = <0xffffffff>;
				qcom,panel-te-source = <0x0>;
				qcom,platform-en-gpio = <0xffffffff 0x9 0x0>;
				qcom,platform-te-gpio = <0xffffffff 0x51 0x0>;
			};

			qcom,msm_notifier@0 {
				compatible = "qcom,msm-notifier";
				panel = <0x4 0x5>;
				phandle = <0x1a>;
			};

			qcom,wb-display@0 {
				cell-index = <0x0>;
				compatible = "qcom,wb-display";
				label = "wb_display";
				phandle = <0x19>;
				status = "disabled";
			};
		};
	};

	fragment@8 {
		target = <0xffffffff>;

		__overlay__ {
			connectors = <0x6>;
		};
	};

	fragment@9 {
		target = <0xffffffff>;

		__overlay__ {
			#address-cells = <0x2>;
			#interrupt-cells = <0x4>;
			#size-cells = <0x0>;
			interrupt-controller;

			qcom,pm7250b@2 {
				#address-cells = <0x2>;
				#size-cells = <0x0>;
				compatible = "qcom,spmi-pmic";
				reg = <0x2 0x0>;

				adc_tm@3500 {
					#address-cells = <0x1>;
					#size-cells = <0x0>;
					#thermal-sensor-cells = <0x1>;
					compatible = "qcom,adc-tm5";
					interrupt-names = "thr-int-en";
					interrupts = <0x2 0x35 0x0 0x1>;
					io-channels = <0x8 0x4d 0x8 0x4f>;
					phandle = <0xf>;
					reg = <0x3500 0x100>;

					charger_skin_therm@4d {
						qcom,hw-settle-time = <0xc8>;
						qcom,ratiometric;
						reg = <0x4d>;
					};

					conn_therm@4f {
						qcom,hw-settle-time = <0xc8>;
						qcom,ratiometric;
						reg = <0x4f>;
					};
				};

				bcl-soc {
					#thermal-sensor-cells = <0x0>;
					compatible = "qcom,msm-bcl-soc";
					phandle = <0xe>;
				};

				bcl@1d00 {
					#thermal-sensor-cells = <0x1>;
					compatible = "qcom,bcl-v5";
					interrupt-names = "bcl-lvl0", "bcl-lvl1", "bcl-lvl2";
					interrupts = <0x2 0x1d 0x0 0x0 0x2 0x1d 0x1 0x0 0x2 0x1d 0x2 0x0>;
					phandle = <0xd>;
					reg = <0x1d00 0x100>;
				};

				clock-controller@5b00 {
					#clock-cells = <0x1>;
					assigned-clock-rates = <0x124f800>;
					assigned-clocks = <0xb 0x1>;
					clock-names = "xo";
					clock-output-names = "pm7250b_div_clk1";
					clocks = <0xffffffff 0x0>;
					compatible = "qcom,spmi-clkdiv";
					phandle = <0xb>;
					qcom,num-clkdivs = <0x1>;
					reg = <0x5b00 0x100>;
				};

				pinctrl@c000 {
					#gpio-cells = <0x2>;
					compatible = "qcom,spmi-gpio";
					gpio-controller;
					interrupt-names = "pm7250b_gpio1", "pm7250b_gpio2", "pm7250b_gpio3", "pm7250b_gpio4", "pm7250b_gpio5", "pm7250b_gpio6", "pm7250b_gpio7", "pm7250b_gpio8", "pm7250b_gpio9", "pm7250b_gpio10", "pm7250b_gpio11", "pm7250b_gpio12";
					interrupts = <0x2 0xc0 0x0 0x0 0x2 0xc1 0x0 0x0 0x2 0xc2 0x0 0x0 0x2 0xc3 0x0 0x0 0x2 0xc4 0x0 0x0 0x2 0xc5 0x0 0x0 0x2 0xc6 0x0 0x0 0x2 0xc7 0x0 0x0 0x2 0xc8 0x0 0x0 0x2 0xc9 0x0 0x0 0x2 0xca 0x0 0x0 0x2 0xcb 0x0 0x0>;
					phandle = <0x2>;
					reg = <0xc000 0xc00>;

					disp_lcd_bias_en {

						disp_lcd_bias_en_default {
							bias-disable;
							function = "func1";
							input-disable;
							output-enable;
							phandle = <0x3>;
							pins = "gpio5";
							power-source = <0x0>;
							qcom,drive-strength = <0x2>;
						};
					};
				};

				qcom,power-on@800 {
					compatible = "qcom,qpnp-power-on";
					reg = <0x800 0x100>;
				};

				qcom,qpnp-smb5 {
					#address-cells = <0x1>;
					#cooling-cells = <0x2>;
					#size-cells = <0x1>;
					compatible = "qcom,qpnp-smb5";
					dpdm-supply = <0xffffffff>;
					io-channel-names = "usb_in_voltage", "usb_in_current", "chg_temp", "die_temp", "conn_temp", "sbux_res", "vph_voltage";
					io-channels = <0x8 0x8 0x8 0x7 0x8 0x9 0x8 0x6 0x8 0x4f 0x8 0x99 0x8 0x83>;
					phandle = <0x1b>;
					qcom,auto-recharge-soc = <0x62>;
					qcom,batteryless-platform;
					qcom,charger-temp-max = <0x320>;
					qcom,hvdcp2-12v-max-icl-ua = <0x16e360>;
					qcom,hvdcp2-max-icl-ua = <0x1e8480>;
					qcom,pmic-revid = <0x7>;
					qcom,sec-charger-config = <0x0>;
					qcom,step-charging-enable;
					qcom,suspend-input-on-debug-batt;
					qcom,sw-jeita-enable;
					qcom,thermal-mitigation = <0x5265c0 0x44aa20 0x3d0900 0x3567e0 0x2dc6c0 0x2625a0 0x1e8480 0x16e360 0xf4240 0x7a120>;
					status = "ok";

					qcom,batif@1200 {
						interrupt-names = "bat-temp", "bat-ov", "bat-low", "bat-therm-or-id-missing", "bat-terminal-missing", "buck-oc", "vph-ov";
						interrupts = <0x2 0x12 0x0 0x1 0x2 0x12 0x2 0x3 0x2 0x12 0x3 0x3 0x2 0x12 0x4 0x3 0x2 0x12 0x5 0x3 0x2 0x12 0x6 0x3 0x2 0x12 0x7 0x3>;
						reg = <0x1200 0x100>;
					};

					qcom,chg-sdam@b000 {
						reg = <0xb000 0x100>;
					};

					qcom,chgr@1000 {
						interrupt-names = "chgr-error", "chg-state-change", "step-chg-state-change", "step-chg-soc-update-fail", "step-chg-soc-update-req", "fg-fvcal-qualified", "vph-alarm", "vph-drop-prechg";
						interrupts = <0x2 0x10 0x0 0x1 0x2 0x10 0x1 0x1 0x2 0x10 0x2 0x1 0x2 0x10 0x3 0x1 0x2 0x10 0x4 0x1 0x2 0x10 0x5 0x1 0x2 0x10 0x6 0x1 0x2 0x10 0x7 0x1>;
						reg = <0x1000 0x100>;
					};

					qcom,dc@1400 {
						interrupt-names = "dcin-vashdn", "dcin-uv", "dcin-ov", "dcin-plugin", "dcin-revi", "dcin-pon", "dcin-en";
						interrupts = <0x2 0x14 0x1 0x3 0x2 0x14 0x2 0x3 0x2 0x14 0x3 0x3 0x2 0x14 0x4 0x3 0x2 0x14 0x5 0x3 0x2 0x14 0x6 0x1 0x2 0x14 0x7 0x1>;
						reg = <0x1400 0x100>;
					};

					qcom,dcdc@1100 {
						interrupt-names = "otg-fail", "otg-oc-disable-sw", "otg-oc-hiccup", "bsm-active", "high-duty-cycle", "input-current-limiting", "concurrent-mode-disable", "switcher-power-ok";
						interrupts = <0x2 0x11 0x0 0x1 0x2 0x11 0x1 0x1 0x2 0x11 0x2 0x1 0x2 0x11 0x3 0x3 0x2 0x11 0x4 0x3 0x2 0x11 0x5 0x3 0x2 0x11 0x6 0x1 0x2 0x11 0x7 0x3>;
						reg = <0x1100 0x100>;
					};

					qcom,misc@1600 {
						interrupt-names = "wdog-snarl", "wdog-bark", "aicl-fail", "aicl-done", "smb-en", "imp-trigger", "temp-change", "temp-change-smb";
						interrupts = <0x2 0x16 0x0 0x1 0x2 0x16 0x1 0x1 0x2 0x16 0x2 0x1 0x2 0x16 0x3 0x1 0x2 0x16 0x4 0x3 0x2 0x16 0x5 0x1 0x2 0x16 0x6 0x1 0x2 0x16 0x7 0x1>;
						reg = <0x1600 0x100>;
					};

					qcom,smb5-vbus {
						phandle = <0x9>;
						regulator-name = "smb5-vbus";
					};

					qcom,smb5-vconn {
						phandle = <0xa>;
						regulator-name = "smb5-vconn";
					};

					qcom,typec@1500 {
						interrupt-names = "typec-or-rid-detect-change", "typec-vpd-detect", "typec-cc-state-change", "typec-vconn-oc", "typec-vbus-change", "typec-attach-detach", "typec-legacy-cable-detect", "typec-try-snk-src-detect";
						interrupts = <0x2 0x15 0x0 0x1 0x2 0x15 0x1 0x1 0x2 0x15 0x2 0x1 0x2 0x15 0x3 0x1 0x2 0x15 0x4 0x1 0x2 0x15 0x5 0x1 0x2 0x15 0x6 0x1 0x2 0x15 0x7 0x1>;
						reg = <0x1500 0x100>;
					};

					qcom,usb@1300 {
						interrupt-names = "usbin-collapse", "usbin-vashdn", "usbin-uv", "usbin-ov", "usbin-plugin", "usbin-revi-change", "usbin-src-change", "usbin-icl-change";
						interrupts = <0x2 0x13 0x0 0x3 0x2 0x13 0x1 0x3 0x2 0x13 0x2 0x3 0x2 0x13 0x3 0x3 0x2 0x13 0x4 0x3 0x2 0x13 0x5 0x3 0x2 0x13 0x6 0x1 0x2 0x13 0x7 0x1>;
						reg = <0x1300 0x100>;
					};
				};

				qcom,revid@100 {
					compatible = "qcom,qpnp-revid";
					phandle = <0x7>;
					reg = <0x100 0x100>;
				};

				qcom,temp-alarm@2400 {
					#thermal-sensor-cells = <0x0>;
					compatible = "qcom,spmi-temp-alarm";
					interrupts = <0x2 0x24 0x0 0x3>;
					io-channel-names = "thermal";
					io-channels = <0x8 0x6>;
					phandle = <0xc>;
					qcom,temperature-threshold-set = <0x1>;
					reg = <0x2400 0x100>;
				};

				qcom,usb-pdphy@1700 {
					compatible = "qcom,qpnp-pdphy";
					interrupt-names = "sig-tx", "sig-rx", "msg-tx", "msg-rx", "msg-tx-failed", "msg-tx-discarded", "msg-rx-discarded", "fr-swap";
					interrupts = <0x2 0x17 0x0 0x1 0x2 0x17 0x1 0x1 0x2 0x17 0x2 0x1 0x2 0x17 0x3 0x1 0x2 0x17 0x4 0x1 0x2 0x17 0x5 0x1 0x2 0x17 0x6 0x1 0x2 0x17 0x7 0x1>;
					phandle = <0x1c>;
					qcom,default-sink-caps = <0x1388 0xbb8 0x2328 0xbb8 0x2ee0 0x8ca>;
					reg = <0x1700 0x100>;
					vbus-supply = <0x9>;
					vconn-supply = <0xa>;
					vdd-pdphy-supply = <0xffffffff>;
				};

				qpnp,qg {
					#address-cells = <0x1>;
					#size-cells = <0x1>;
					compatible = "qcom,qpnp-qg";
					io-channel-names = "batt-therm", "batt-id";
					io-channels = <0x8 0x4a 0x8 0x4b>;
					phandle = <0x1d>;
					qcom,cl-feedback-on;
					qcom,hold-soc-while-full;
					qcom,linearize-soc;
					qcom,pmic-revid = <0x7>;
					qcom,qg-iterm-ma = <0x96>;
					qcom,s3-entry-fifo-length = <0x2>;
					qcom,vbatt-cutoff-mv = <0xc80>;
					qcom,vbatt-empty-cold-mv = <0xbb8>;
					qcom,vbatt-empty-mv = <0xbb8>;
					qcom,vbatt-low-cold-mv = <0xe74>;
					qcom,vbatt-low-mv = <0xce4>;
					status = "ok";

					qcom,qg-sdam@b100 {
						reg = <0xb100 0x100>;
						status = "okay";
					};

					qcom,qgauge@4800 {
						interrupt-names = "qg-batt-missing", "qg-vbat-low", "qg-vbat-empty", "qg-fifo-done", "qg-good-ocv";
						interrupts = <0x2 0x48 0x0 0x3 0x2 0x48 0x1 0x3 0x2 0x48 0x2 0x1 0x2 0x48 0x3 0x1 0x2 0x48 0x4 0x1>;
						reg = <0x4800 0x100>;
						status = "okay";
					};
				};

				vadc@3100 {
					#address-cells = <0x1>;
					#io-channel-cells = <0x1>;
					#size-cells = <0x0>;
					compatible = "qcom,spmi-adc5";
					interrupt-names = "eoc-int-en-set";
					interrupts = <0x2 0x31 0x0 0x1>;
					io-channel-ranges;
					phandle = <0x8>;
					qcom,adc-vdd-reference = <0x753>;
					reg = <0x3100 0x100>;
					reg-names = "adc5-usr-base";

					bat_id@4b {
						label = "bat_id";
						qcom,hw-settle-time = <0xc8>;
						qcom,pre-scaling = <0x1 0x1>;
						qcom,ratiometric;
						reg = <0x4b>;
					};

					bat_therm@4a {
						label = "bat_therm";
						qcom,hw-settle-time = <0xc8>;
						qcom,pre-scaling = <0x1 0x1>;
						qcom,ratiometric;
						reg = <0x4a>;
					};

					bat_therm_30k@2a {
						label = "bat_therm_30k";
						qcom,hw-settle-time = <0xc8>;
						qcom,pre-scaling = <0x1 0x1>;
						qcom,ratiometric;
						reg = <0x2a>;
					};

					bat_therm_400k@6a {
						label = "bat_therm_400k";
						qcom,hw-settle-time = <0xc8>;
						qcom,pre-scaling = <0x1 0x1>;
						qcom,ratiometric;
						reg = <0x6a>;
					};

					charger_skin_therm@4d {
						label = "charger_skin_therm";
						qcom,hw-settle-time = <0xc8>;
						qcom,pre-scaling = <0x1 0x1>;
						qcom,ratiometric;
						reg = <0x4d>;
					};

					chg_sbux@99 {
						label = "chg_sbux";
						qcom,pre-scaling = <0x1 0x3>;
						reg = <0x99>;
					};

					chg_temp@9 {
						label = "chg_temp";
						qcom,pre-scaling = <0x1 0x1>;
						reg = <0x9>;
					};

					conn_therm@4f {
						label = "conn_therm";
						qcom,hw-settle-time = <0xc8>;
						qcom,pre-scaling = <0x1 0x1>;
						qcom,ratiometric;
						reg = <0x4f>;
					};

					die_temp@2 {
						label = "die_temp";
						qcom,pre-scaling = <0x1 0x1>;
						reg = <0x6>;
					};

					mid_chg_div6@1e {
						label = "chg_mid";
						qcom,pre-scaling = <0x1 0x6>;
						reg = <0x1e>;
					};

					ref_gnd@0 {
						label = "ref_gnd";
						qcom,pre-scaling = <0x1 0x1>;
						reg = <0x0>;
					};

					smb1390_therm@e {
						label = "smb1390_therm";
						qcom,hw-settle-time = <0xc8>;
						qcom,pre-scaling = <0x1 0x1>;
						reg = <0xe>;
					};

					usb_in_i_uv@7 {
						label = "usb_in_i_uv";
						qcom,pre-scaling = <0x1 0x1>;
						reg = <0x7>;
					};

					usb_in_v_div_16@8 {
						label = "usb_in_v_div_16";
						qcom,pre-scaling = <0x1 0x10>;
						reg = <0x8>;
					};

					v_i_int_ext@b0 {
						label = "v_i_int_vbat_vdata";
						qcom,pre-scaling = <0x1 0x1>;
						reg = <0xb0>;
					};

					v_i_parallel@b0 {
						label = "v_i_parallel_vbat_vdata";
						qcom,pre-scaling = <0x1 0x1>;
						reg = <0xb4>;
					};

					vbat_sns@84 {
						label = "vbat_sns";
						qcom,pre-scaling = <0x1 0x3>;
						reg = <0x84>;
					};

					vph_pwr@83 {
						label = "vph_pwr";
						qcom,pre-scaling = <0x1 0x3>;
						reg = <0x83>;
					};

					vref_1p25@1 {
						label = "vref_1p25";
						qcom,pre-scaling = <0x1 0x1>;
						reg = <0x1>;
					};
				};
			};

			qcom,pm7250b@3 {
				#address-cells = <0x2>;
				#size-cells = <0x0>;
				compatible = "qcom,spmi-pmic";
				reg = <0x3 0x0>;

				qcom,vibrator@5300 {
					compatible = "qcom,qpnp-vibrator-ldo";
					phandle = <0x1e>;
					qcom,disable-overdrive;
					qcom,vib-ldo-volt-uv = <0x2dc6c0>;
					reg = <0x5300 0x100>;
				};
			};
		};
	};
};
